## device/mx/mx8855/sound/soc/samsung/exynos/abox/Kconfig
```kconfig
config SEC_SND_SYNCHRONIZED_IPC_AW
	tristate "Samsung SYNC IPC AW"
	help
	  Say Y or M if you want to add support for external devices attached to
	  the Samsung SoC ABOX interface. You will also need to
	  select the audio interfaces to support below.

config SEC_SND_SYNCHRONIZED_IPC_TI
	tristate "Samsung SYNC IPC TI"
	help
	  Say Y or M if you want to add support for external devices attached to
	  the Samsung SoC ABOX interface. You will also need to
	  select the audio interfaces to support below.
```

## external-modules/camera/Kconfig
```kconfig
# SPDX-License-Identifier: GPL-2.0

source "$(KCONFIG_EXT_MODULES_PREFIX)camera/camera/Kconfig"
```

## external-modules/sgpu/Kconfig
```kconfig
# SPDX-License-Identifier: GPL-2.0

source "$(KCONFIG_EXT_MODULES_PREFIX)sgpu/sgpu/Kconfig"
source "$(KCONFIG_EXT_MODULES_PREFIX)sgpu/test/Kconfig"
```

## external-modules/sgpu/sgpu/Kconfig
```kconfig
# SPDX-License-Identifier: MIT
config DRM_SGPU
	tristate "Samsung GPU"
	depends on DRM && MMU
	select FW_LOADER
	select DRM_KMS_HELPER
	select DRM_SCHED
	select DRM_TTM
	select DRM_TTM_HELPER
	select POWER_SUPPLY
	select INTERVAL_TREE
	select CHASH
	select TRACE_GPU_MEM
	help
	  Choose this option if you have a recent SGPU.

	  If M is selected, the module will be called sgpu.

config DRM_SGPU_BUILTIN_FIRMWARE
	bool "Enable use of built-in firmware"
	depends on DRM_SGPU
	default y
	help
	  Selecting this option enables linking firmware binaries into the driver.

config DRM_SGPU_EMULATION_GPU_ONLY
	bool "Enable emulation mode"
	depends on DRM_SGPU
	default n
	help
	  Selecting this option enables emulation mode by default. Emulation
	  mode is required for running on QEMU or hardware emulator.

config DRM_SGPU_EMULATION_FULL_SOC
	bool "Enable emulation mode"
	depends on DRM_SGPU
	default n
	help
	  Selecting this option enables workaround for SoC emulators like
	  Palladium and ZeBu. They emulate a lot of components of SoC but
	  are missing some components that causes serious performance impact.
	  The time in the emulators is also very different from the time in
	  silicon. Select this option if you are compiling for ZeBu or
	  Palladium.

config DRM_SGPU_EXYNOS
	bool "Enable Exynos related code"
	depends on DRM_SGPU
	default n
	help
	  This option is for SGPU in Exynos.

config DRM_SGPU_DVFS
	bool "Enable DVFS related code"
	depends on DRM_SGPU
	depends on PM_DEVFREQ
	default n
	help
	  This option is for DVFS framework in SGPU

config DRM_SGPU_GVF
	bool "Enable GPU Virtual Frequency"
	depends on DRM_SGPU
	depends on DRM_SGPU_DVFS
	default n
	help
	  GVF(GPU Virtual Frequency) is a GPU power control function to imitate
	  lower frequency of GPU which cannot be applied in real. This function
	  reduces GPU power more extremely to meet target performance in sustain
	  conditions, by controling GPU power dynamincally and forcebly.

config DRM_SGPU_AFM
	bool "Enable GPU AFM feature"
	depends on DRM_SGPU_DVFS
	default n
	help
	  AFM is Adaptive Frequency Manager. PMIC assert AFM_WARN signal when
	  over-current situation is detected. HTU_G3D receives this signal
	  and makes interrupt notifying over-currency to KMD. GPU DVFS need to
	  down the GPU frequency for ensuring GPU stability.
	  GPU AFM driver lock the gpu's max frequency when PMIC AFM_WARN
	  interrupt is occurred.

config DRM_SGPU_WORKTIME
	bool "Enable gpu_work_period"
	depends on DRM_SGPU && FTRACE
	default n
	help
	 From Android 14, GPU driver should provide the command
	 "dumpsys gpu --gpuwork" to display the aggregated GPU work data
	 returned by the power/gpu_work_period kernel tracepoint.

config DRM_SGPU_VENDOR_HOOKS
	bool "Enable VENDOR HOOKS function"
	depends on DRM_SGPU
	depends on ANDROID_VENDOR_HOOKS
	default y
	help
	 At Android, GPU driver need to hook function that provides
	 memory information using GPU. This option is enabled when
	 "android_vh_show_mem" are incldued.

config DRM_SGPU_FORCE_WRITECOMBINE
	bool "Force all GPU buffers write-combining for non-coherenty GPU"
	depends on DRM_SGPU_EXYNOS
	default y
	help
	  If GPU does have memory coherent with the host CPUs, GPU drivers
	  should make sure the GPU bufffers shared with CPU are coherent.
	  The cost of extra SW overhead for memory coherency can be significant
	  while the latency of an access to write-combining memory is dramatically
	  slow. Set n if PAL is able to handle all memory coherency for cacheable
	  buffer objects and performance impact of SW overhead for memory coherency
	  is neglectable.

config DRM_SGPU_GRAPHIC_MEMORY_RECLAIM
	bool "Graphics Memory Reclamation"
	depends on DRM_SGPU_EXYNOS
	default y
	help
	  Choose this option to create sysfs files for reclaiming GEM buffers.

config DRM_AMDGPU_GART_DEBUGFS
	bool "Allow GART access through debugfs"
	depends on DRM_SGPU
	depends on DEBUG_FS
	default n
	help
	  Selecting this option creates a debugfs file to inspect the mapped
	  pages. Uses more memory for housekeeping, enable only for debugging.

config DRM_AMDGPU_DUMP
	bool "Enable AMDGPU GPU dump upon GPU hang"
	depends on DRM_SGPU
	default y
	help
	  Selecting this option enables support for persisting AMDGPU's
	  different blocks register status upon GPU hang.

config DRM_AMDGPU_GMC_DUMP
	bool "Persist GMC block's status"
	depends on DRM_AMDGPU_DUMP
	default y
	help
	  Selecting this option enables support for persisting
	  AMDGPU's GMC block register status upon GPU hang.

config DRM_AMDGPU_GFX_DUMP
	bool "Persist GFX block's status"
	depends on DRM_AMDGPU_DUMP
	default y
	help
	  Selecting this option enables support for persisting
	  AMDGPU's GFX block register status upon GPU hang.

config DRM_AMDGPU_COMPUTE_DUMP
	bool "Persist COMPUTE block's status"
	depends on DRM_AMDGPU_DUMP
	default y
	help
	  Selecting this option enables support for persisting
	  AMDGPU's COMPUTE block register status upon GPU hang.

config DRM_AMDGPU_SDMA_DUMP
	bool "Persist SDMA block's status"
	depends on DRM_AMDGPU_DUMP
	default y
	help
	  Selecting this option enables support for persisting
	  AMDGPU's SDMA block register status upon GPU hang.

choice
	prompt "SGPU DRM dump's sink"
	depends on DRM_AMDGPU_DUMP
	default DRM_SGPU_DUMP_LOG
	help
	  Choose where to write the dump

config DRM_SGPU_DUMP_LOG
	bool "Dump to log"

config DRM_SGPU_DUMP_PSTORE
	bool "Dump to pstore"
	depends on PSTORE
	depends on DRM_DUMP

endchoice

config DRM_SGPU_BPMD
	bool "Enable BPMD (Binary PostMortem Dump)"
	depends on DRM_SGPU
	default n
	help
	  This option is for SGPU BPMD.

config DRM_SGPU_BPMD_FILE_DUMP
	bool "Enable dumping BPMD data into a file"
	depends on DRM_SGPU_BPMD
	default n
	help
	  This option is for dumping SGPU BPMD data into a file in kernel.

config DRM_SGPU_BPMD_OUTPUT_DEFAULT
	string "Default path to BMPD's output"
	depends on DRM_SGPU_BPMD
	default "/tmp"
	help
	  Serves as a default value for the `bmpdpath` module parameter

config DRM_SGPU_BPMD_MEMLOGGER_TEXT
	bool "Enable dumping textual dump to memloger"
	depends on EXYNOS_MEMORY_LOGGER
	select DRM_SGPU_BPMD
	default n

config DRM_SGPU_RUNTIME_PM
	bool "Enable runtime PM"
	depends on PM
	depends on DRM_SGPU_EXYNOS
	depends on !DRM_SGPU_EMULATION_GPU_ONLY
	depends on !DRM_SGPU_EMULATION_FULL_SOC
	default n

choice
	prompt "GPU Version"
	depends on DRM_SGPU
	default GPU_VERSION_M3
	help
	  This option helps to include the correct version of header files

config GPU_VERSION_M0
	bool "Enable GPU Version M0"

config GPU_VERSION_M1
	bool "Enable GPU Version M1"

config GPU_VERSION_M2
	bool "Enable GPU Version M2"

config GPU_VERSION_M3
	bool "Enable GPU Version M3"

config GPU_VERSION_M2_MID
        bool "Enable GPU Version M2 mid"

endchoice

config DRM_SGPU_UNKNOWN_REGISTERS_ENABLE
	bool "Enable unknown registers"
	depends on DRM_SGPU
	default n
	help
	  This config provide an option to enable/disable the unknown registers
	  by default. These unknown registers are not for mobile GPU as per the
	  cosmos register map but these registers are used in the current code.
```

## external-modules/sgpu/test/Kconfig
```kconfig
# SPDX-License-Identifier: MIT

config SGPU_EXYNOS_KUNIT_TEST
	tristate "KUnit tests for SGPU" if !KUNIT_ALL_TESTS
	depends on KUNIT
	depends on DRM_SGPU
	default KUNIT_ALL_TESTS
```

## soc-series/s-android15/Kconfig.ext
```kconfig
# SPDX-License-Identifier: GPL-2.0

menu  "Exynos SOC require Modules"

config VENDOR_NR_CPUS
	int "Maximum number of CPUs (2-4096) governed by vendor"
	range 2 4096
	default "10"

config SOC_S5E9945
	bool "Samsung S5E9945"
	select ARCH_EXYNOS
	help
	  Support Samsung SOC S5E9945.

config SOC_S5E9955
	bool "Samsung S5E9955"
	select ARCH_EXYNOS
	help
	  Support Samsung SOC S5E9955.

config SOC_S5E8855
	bool "Samsung S5E8855"
	select ARCH_EXYNOS
	help
	  Support Samsung SOC S5E8855.

config EXYNOS_EMULATOR
	bool "Samsung Exynos Emulator"
	select ARCH_EXYNOS
	help
	  Support Samsung Exynos Emulator that has Virtual I/O only.

source "$(KCONFIG_EXT_SOC_PREFIX)drivers/clocksources/Kconfig"

source "$(KCONFIG_EXT_SOC_PREFIX)drivers/tty/serial/Kconfig"

source "$(KCONFIG_EXT_SOC_PREFIX)drivers/i2c/busses/Kconfig"

source "$(KCONFIG_EXT_SOC_PREFIX)drivers/spi/Kconfig"

source "$(KCONFIG_EXT_SOC_PREFIX)drivers/i3c/Kconfig"

source "$(KCONFIG_EXT_SOC_PREFIX)drivers/clk/samsung/Kconfig"

source "$(KCONFIG_EXT_SOC_PREFIX)drivers/soc/samsung/exynos/Kconfig"

source "$(KCONFIG_EXT_SOC_PREFIX)drivers/power/reset/exynos/Kconfig"

source "$(KCONFIG_EXT_SOC_PREFIX)drivers/pinctrl/samsung/Kconfig"

source "$(KCONFIG_EXT_SOC_PREFIX)drivers/iommu/samsung/Kconfig"

source "$(KCONFIG_EXT_SOC_PREFIX)drivers/dma-buf/heaps/samsung/Kconfig"

source "$(KCONFIG_EXT_SOC_PREFIX)drivers/ufs/host/Kconfig"

source "$(KCONFIG_EXT_SOC_PREFIX)drivers/mmc/host/Kconfig"

source "$(KCONFIG_EXT_SOC_PREFIX)drivers/pwm/Kconfig"

source "$(KCONFIG_EXT_SOC_PREFIX)drivers/watchdog/Kconfig"

source "$(KCONFIG_EXT_SOC_PREFIX)drivers/bts/Kconfig"

source "$(KCONFIG_EXT_SOC_PREFIX)drivers/soc/samsung/Kconfig"

source "$(KCONFIG_EXT_SOC_PREFIX)drivers/dma/samsung/Kconfig"

source "$(KCONFIG_EXT_SOC_PREFIX)drivers/devfreq/Kconfig"

source "$(KCONFIG_EXT_SOC_PREFIX)drivers/thermal/Kconfig"

source "$(KCONFIG_EXT_SOC_PREFIX)drivers/dpu/Kconfig"

source "$(KCONFIG_EXT_SOC_PREFIX)drivers/mfd/Kconfig"

source "$(KCONFIG_EXT_SOC_PREFIX)drivers/regulator/Kconfig"

source "$(KCONFIG_EXT_SOC_PREFIX)drivers/rtc/Kconfig"

source "$(KCONFIG_EXT_SOC_PREFIX)drivers/input/keyboard/Kconfig"

source "$(KCONFIG_EXT_SOC_PREFIX)drivers/iio/adc/Kconfig"

source "$(KCONFIG_EXT_SOC_PREFIX)drivers/pinctrl/Kconfig"

source "$(KCONFIG_EXT_SOC_PREFIX)drivers/mfd/samsung/Kconfig"

source "$(KCONFIG_EXT_SOC_PREFIX)drivers/power/supply/samsung/Kconfig"

source "$(KCONFIG_EXT_SOC_PREFIX)drivers/misc/samsung/Kconfig"

source "$(KCONFIG_EXT_SOC_PREFIX)drivers/net/wireless/Kconfig"

source "$(KCONFIG_EXT_SOC_PREFIX)drivers/soc/samsung/exynos/debug/Kconfig"

source "$(KCONFIG_EXT_SOC_PREFIX)drivers/phy/samsung/Kconfig"

source "$(KCONFIG_EXT_SOC_PREFIX)drivers/usb/dwc3/Kconfig"

source "$(KCONFIG_EXT_SOC_PREFIX)drivers/usb/host/Kconfig"

source "$(KCONFIG_EXT_SOC_PREFIX)sound/usb/Kconfig"

source "$(KCONFIG_EXT_SOC_PREFIX)drivers/usb/gadget/function/Kconfig"

source "$(KCONFIG_EXT_SOC_PREFIX)kernel/sched/ems/Kconfig"

source "$(KCONFIG_EXT_SOC_PREFIX)drivers/cpufreq/Kconfig"

source "$(KCONFIG_EXT_SOC_PREFIX)drivers/vision/Kconfig"

source "$(KCONFIG_EXT_SOC_PREFIX)drivers/soc/samsung/exynos/exynos-el2/Kconfig"

source "$(KCONFIG_EXT_SOC_PREFIX)drivers/staging/nanohub/Kconfig"

source "$(KCONFIG_EXT_SOC_PREFIX)drivers/soc/samsung/exynos/exynos-pkvm-module/Kconfig"

source "$(KCONFIG_EXT_SOC_PREFIX)drivers/smfc/Kconfig"

source "$(KCONFIG_EXT_SOC_PREFIX)drivers/mfc/Kconfig"

source "$(KCONFIG_EXT_SOC_PREFIX)drivers/scaler/Kconfig"

source "$(KCONFIG_EXT_SOC_PREFIX)drivers/soc/samsung/exynos/cpif/Kconfig"

source "$(KCONFIG_EXT_SOC_PREFIX)drivers/soc/samsung/exynos/gnssif/Kconfig"

source "$(KCONFIG_EXT_SOC_PREFIX)drivers/clo/Kconfig"

source "$(KCONFIG_EXT_SOC_PREFIX)drivers/pci/controller/dwc/Kconfig"

source "$(KCONFIG_EXT_SOC_PREFIX)sound/soc/samsung/exynos/Kconfig"

source "$(KCONFIG_EXT_SOC_PREFIX)sound/soc/codecs/Kconfig"

source "$(KCONFIG_EXT_SOC_PREFIX)drivers/tsmux/Kconfig"

source "$(KCONFIG_EXT_SOC_PREFIX)drivers/repeater/Kconfig"

source "$(KCONFIG_EXT_SOC_PREFIX)drivers/scsi/Kconfig"

source "$(KCONFIG_EXT_SOC_PREFIX)drivers/irqchip/exynos/Kconfig"

source "$(KCONFIG_EXT_SOC_PREFIX)drivers/block/zram/Kconfig"

source "$(KCONFIG_EXT_SOC_PREFIX)drivers/nfc/samsung/Kconfig"

source "$(KCONFIG_EXT_SOC_PREFIX)mm/sec_mm/Kconfig"

endmenu
```

## soc-series/s-android15/drivers/clk/samsung/Kconfig
```kconfig
# SPDX-License-Identifier: GPL-2.0-only
# Recent Exynos platforms should just select COMMON_CLK_SAMSUNG:

config COMPOSITE_CLK_SAMSUNG
	tristate "Samsung Exynos clock controller support"
	select COMMON_CLK_SAMSUNG
	depends on CAL_IF
```
