## device/erd/erd8855/Kconfig.ext
```kconfig
source "$(KCONFIG_EXT_SOC_PREFIX)Kconfig.ext"

source "$(KCONFIG_EXT_PREFIX)Kconfig.ext_modules"
```

## device/erd/erd8855/Kconfig.ext_modules
```kconfig
source "$(KCONFIG_EXT_MODULES_PREFIX)sgpu/Kconfig"
source "$(KCONFIG_EXT_PREFIX)../common/drivers/input/touchscreen/sec_ts/Kconfig"
source "$(KCONFIG_EXT_MODULES_PREFIX)camera/camera/Kconfig"
```

## device/mx/mx8855/Kconfig.ext_modules
```kconfig
source "$(KCONFIG_EXT_MODULES_PREFIX)sgpu/Kconfig"
source "$(KCONFIG_EXT_MODULES_PREFIX)camera/camera/Kconfig"
```

## device/mx/mx8855/drivers/camera/Kconfig
```kconfig
config IS_VENDOR_INTERFACE
	tristate "Image subsystem vendor interface"
	default n
	help
	  If this config is set, Image subsystem vendor interface module is added
	  for commuication between external camera module and vendor module.
```

## device/mx/mx8855/drivers/leds/Kconfig
```kconfig
# SPDX-License-Identifier: GPL-2.0-only

config LEDS_S2MF301_FLASH
	tristate "FLASH LED support for the S2MF301"
	depends on (MFD_S2MF301) && I2C
	help
	  If you say yes here you will get support for
	  the LEDS_S2MF301_FLASH led chip.
```

## device/mx/mx8855/drivers/lego/Kconfig
```kconfig
config HELLO_LEGO
	tristate "HELLO LEGO Module"
	default n
	help
	  Enable Hello lego Feature
```

## device/mx/mx8855/drivers/mmc/host/Kconfig
```kconfig
# drivers/mmc/host/Kconfig
#
# Copyright (c) 2010-2024 Samsung Electronics Co., Ltd.
#		http://www.samsung.com/
#
# Licensed under GPLv2
#
comment "Samsung Mobile MMC Options"
menuconfig SEC_MMC
	bool "Samsung MMC feature"
	default n
	help
	  Enable Samsung mmc feature.
```

## device/mx/mx8855/drivers/samsung/Kconfig
```kconfig
source "$(KCONFIG_EXT_PREFIX)drivers/samsung/pm/Kconfig"
source "$(KCONFIG_EXT_PREFIX)drivers/samsung/debug/Kconfig"

config SEC_BOOTSTAT
	tristate "Enable TN Bootstat logging"
  depends on DRV_SAMSUNG
	default n
	help
	  This adds support for Samsung boot-stat
	  To compile this driver as a module, choose M here.

config SEC_KEY_NOTIFIER
	tristate "Enable Samsung key event notifier"
	default n
	help
	  Samsung Key input event notifier

config SEC_KN_WATCH
	bool "Change keys to support watch in event notifier"
	default n
	help
		Enable this option for watch devices.
		This will change the hold, primary, and secondary key to
		support crash key and hard reset hook in watch devices.

		          |     Phone      |     Watch
		------------------------------------------
		Hold      | KEY_VOLUMEDOWN | KEY_APPSELECT
		------------------------------------------
		Primary   | KEY_POWER      | KEY_APPSELECT
		------------------------------------------
		Secondary | KEY_VOLUMEUP   | KEY_POWER
		------------------------------------------

config CRASH_KEY_USER
	tristate "Enable Samsung Crash Key 953"
	depends on SEC_KEY_NOTIFIER
	default n
	help
		This adds support for user crash key. To panic the device, while pressing
		the hold key (not for watch, since hold and primary keys are identical)
		press the primary key 9 times, secondary key 5 times, and finally
		primary key 3 times. Keep pressing the hold key (primary key for watch)
		until upload mode appears.

config HARD_RESET_HOOK
	tristate "Enable 7s hard reset hook"
	depends on SEC_KEY_NOTIFIER
	default n
	help
		This adds support for hard reset.
		To panic the device, keep pressing both the hold key
		and the primary(secondary for watch) key for 7 seconds.

# drivers/samsung/Kconfig
#
# Copyright (c) 2010-2020 Samsung Electronics Co., Ltd.
#               http://www.samsung.com/
#
# Licensed under GPLv2
config SEC_REBOOT
	tristate "Enable Samsung reboot features"
	default n
	help
	  Samsung TN reboot extension Feature. Do additional work when reboot.


comment "Samsung sysfs Feature"
config DRV_SAMSUNG
	tristate "Samsung sec class/sysfs Feature"
	default n
	help
	  Samsung sysfs name 'sec' directory create.
```

## device/mx/mx8855/drivers/samsung/debug/Kconfig
```kconfig
# drivers/samsung/debug/Kconfig
#
# Copyright (c) 2010-2020 Samsung Electronics Co., Ltd.
#               http://www.samsung.com/
#
# Licensed under GPLv2

menuconfig SEC_DEBUG
	tristate "Enable Samsung Debugging features"
	default m

if SEC_DEBUG

config SEC_DEBUG_BASE
	tristate "Enable Samsung debug fundamentals"
	default m
	help
	  Samsung Debug Base Driver

config SEC_DEBUG_MODE
	tristate "Enable Samsung force upload mode support"
	default m
	help
	  This option enables get force upload
	  This option call dbg_snapshot_scratch_clear
	  according to force_upload variables

config SEC_DEBUG_EXTRA_INFO
	tristate "Enable Samsung reset reason extra info"
	default m
	help
	  This option enables storing reset reason extra info
	  This option enables ap reset info bigdata
	  based on reset reason extra info

config SEC_DEBUG_HW_PARAM
	tristate "Enable Samsung hw parameter driver"
	default m
	help
	  This option enables storing HW parameter driver
	  This option gets some hardware dependent parameters
	  based on sec debug

config SEC_DEBUG_RESET_REASON
	tristate "Enable Samsung reset reason driver"
	default m
	help
	  This option enables reset reason driver
	  based on sec debug

config SEC_DEBUG_PRINT_PCLR
	bool "Add PC/LR to Panic message for die()"
	default y
	help
	  This option enables PC and LR value present in panic message when the
	  kernel calls die(). It may be useful for upload screen and auto
	  comment.

config SEC_DEBUG_AVOID_UNNECESSARY_TRAP
	bool "avoid unnecessary trap"
	default n
	help
	  This option helps to obtain normal log by avoiding unnessary trap again
	  after exception handling

config SEC_DEBUG_EXCEPTION_SCS
	bool "Preserve shadow call stack data when the exception happened"
	depends on SHADOW_CALL_STACK && SEC_DEBUG_EXCEPTION_STACK
	default n
	help
	  If this is set, kernel can preserve the specific size of shadow
	  call stack data when an exception occurs from EL1. This can help
	  to fiqure out the stack data before the exception happened.

config SEC_DEBUG_WATCHDOGD_FOOTPRINT
	tristate "store watchdogd footprint"
	default m
	help
	  If this config is set, store watchdogd footprint information.

config SEC_DEBUG_LOCKUP_INFO
	bool "Gather softlockup/hardlockup information"
	depends on SEC_DEBUG_HARDLOCKUP_INFO
	default y
	help
	  Gather softlockup/hardlockup information for auto analysis

config SEC_DEBUG_BAD_STACK_CAREFULLY
	bool "Handle bad_stack more carefully"
	default n
	help
	  This options prevent infinite abort loop about stack corruption.

config SEC_DEBUG_FPSIMD_CHECK_CONTEXT
	bool "Detect for fpsimd has corruption"
	default n
	help
	  If FPSIMD has corruption, use this feature for detect problem.

config SEC_DEBUG_FAIL_TO_FREEZE_PANIC
	bool "Panic on fail to freeze tasks"
	depends on !SAMSUNG_PRODUCT_SHIP
	default y
	help
	  This option enables the kernel to panic on fail to freeze tasks

config SEC_DEBUG_UNFROZEN_TASK
	bool "Set unfrozen task information"
	depends on SEC_DEBUG_FAIL_TO_FREEZE_PANIC
	default y
	help
	  This option enables the kernel to set unfrozen task information

config SEC_DEBUG_EMERG_WDT_CALLER
	bool "Mark a caller for emergency watchdog caller"
	default n
	help
	  This option enables the kernel to indicate a caller of emergency
	  watchdog caller.

config SEC_DEBUG_BAD_STACK_INFO
	bool "Set bad stack informaion"
	default y
	help
	  This option enables the kernel to save additional information when
	  kernel run into handle_bad_stack.

config SEC_DEBUG_DTASK
	tristate "Support uninterruptible sleep task debugging"
	default m
	help
	  This option enables getting information of task with TASK_UNINTERRUPTIBLE.

config SEC_DEBUG_SOFTDOG_PWDT
	tristate "Enable Soft Watchdog for Platform"
	default m
	depends on WATCHDOG
	select SOFT_WATCHDOG_EXT
	help
	  This option enables soft watchdog device and soft_panic.

config SEC_DEBUG_PANIC_ON_RCU_STALL
	bool "Enable panic on rcu stall"
	depends on !SAMSUNG_PRODUCT_SHIP
	depends on TREE_RCU || PREEMPT_RCU
	default n
	help
	  This option enables the kernel to panic on "rcu stall"

config SEC_DEBUG_SCHED_INFO
	tristate
	select SEC_DEBUG_STACKTRACE
	help
	  This option enables to print sched info of short duration.
	  This can be useful to analyze a task lockup.

config SEC_DEBUG_WQ_LOCKUP_INFO
	tristate "Enable workqueue lockup info"
	default m
	depends on WQ_WATCHDOG
	select SEC_DEBUG_SCHED_INFO
	help
	  This option enables enhanced workqueue lockup info. Current information
	  for debugging workqueue lockup is not sufficent.

config SEC_DEBUG_SOFTDOG
	tristate "Enable enhanced softdog info"
	default m
	depends on SOFT_WATCHDOG_EXT
	select SEC_DEBUG_STACKTRACE
	help
	  This option enables enhanced softdog info.
	  Select the option to show related task info.

config SEC_DUMP_SINK
	tristate "Enable to dump_sink"
	default n
	help
	  This option enables dump sink.

config SEC_DEBUG_HANDLE_BAD_STACK
	bool "Support handle bad stack debugging"
	depends on SEC_DEBUG
	default n
	help
	  This option enables to stop cpu when the cpu enter
	  handle_bad_stack again.

config SEC_DEBUG_STACKTRACE
	tristate
	help
	  This option enables to print stack trace.

config SEC_DEBUG_HARDLOCKUP_INFO
	tristate "Enable to hardlockup info"
	depends on DEBUG_SNAPSHOT && EXYNOS_HARDLOCKUP_WATCHDOG
	default m
	help
	  This option enables hardlockup information.
	  Select the option to show debugging information when hardlockup is detected.

config SEC_DEBUG_OBJECTS_ADDITIONAL_INFO
	bool "Add caller information"
	depends on DEBUG_OBJECTS_FREE
	default n
	help
	  Add caller information to debug_obj structure.

config SEC_DEBUG_SCHED_REPORT
	tristate "Enable schded report for debugging"
	depends on DEBUG_SNAPSHOT
	default m
	help
	  This option enables sched report for debugging.
	  Select the option to show sched information when stall issue is detected.

config SEC_DEBUG_KERN_ERR_REPORT
	tristate "Enable reporting kernel error"
	depends on SEC_DEBUG
	default m
	help
	  This option enables to report kernel error like kfence/warn.

config SEC_DEBUG_RESUME_PROFILE
	tristate "Enable the latest resume information profile feature"
	depends on SEC_DEBUG
	default n
	help
	  This option enables to display profile information of the latest resume action

config SEC_DEBUG_SLAB_INFO
	tristate "Enable slab info for debugging"
	default m
	help
	  This option enables slab info for debugging.
	  Select the option to show slab info in case of data abort

config SEC_DEBUG_SCHED_INFO_TEST_FOR_ONLY_UML
	tristate "KUnit test for sec_debug_sched_info_test"
	depends on SEC_KUNIT
	depends on SEC_DEBUG_SCHED_INFO
	help
	  TODO: Describe config fully.
	  This CONFIG is recommended to set to y.

config SEC_DUMP_SINK_TEST_FOR_ONLY_UML
	tristate "KUnit test for sec_dump_sink_test"
	depends on SEC_KUNIT
	depends on SEC_DUMP_SINK
	help
	  TODO: Describe config fully.
	  This CONFIG is recommended to set to y.

endif

config SOFT_WATCHDOG_EXT
	tristate "Software watchdog"
	select WATCHDOG_CORE
	help
	  A software monitoring watchdog. This will fail to reboot your system
	  from some situations that the hardware watchdog will recover
	  from. Equally it's a lot cheaper to install.

	  To compile this driver as a module, choose M here: the
	  module will be called softdog.
```

## device/mx/mx8855/drivers/samsung/pm/Kconfig
```kconfig
# drivers/samsung/pm/Kconfig
#
# Copyright (c) 2010-2024 Samsung Electronics Co., Ltd.
#		http://www.samsung.com/
#
# Licensed under GPLv2
#
comment "Samsung Mobile Power Management Options"
menuconfig SEC_PM
	bool "Samsung Mobile Power Management"
	default n
	help
	  This option enables support for various drivers and features for
	  Samsung Mobile Power Management.

config SEC_PM_CPUPM
	tristate "Enable Samsung Mobile Power management to control CPU PM"
	default n
	depends on SEC_PM
	help
	  This option enables Samsung Mobile Power management CPU PM control support.
	  Intended for controlling CPU power mode.

config SEC_PM_DEBUG
	tristate "Enable Samsung Mobile Power management debug support"
	default n
	depends on SEC_PM
	help
	  This option enables Samsung Mobile Power management debug support.
	  Intended for test and debug only.

config SEC_PM_TMU
	tristate "Enable Samsung Mobile TMU driver for debugging Thermal Management Unit"
	default n
	depends on SEC_PM && EXYNOS_THERMAL_V2
	help
	  This option enables Samsung Mobile Power management Exynos TMU debugging support.
	  Intended for debugging TMU.

config SEC_PM_REGULATOR
	tristate "Enable Samsung Mobile Regulator control driver"
	default n
	depends on SEC_PM && REGULATOR
	help
	  This option enables Samsung Mobile Power regulator control and debugging support.
```

## device/mx/mx8855/drivers/ufs/host/Kconfig
```kconfig
# drivers/ufs/host/Kconfig
#
# Copyright (c) 2010-2024 Samsung Electronics Co., Ltd.
#		http://www.samsung.com/
#
# Licensed under GPLv2
#
comment "Samsung Mobile UFS Options"
menuconfig SEC_UFS
	bool "Samsung UFS feature"
	default n
	help
	  Enable Samsung ufs feature.
```

## device/mx/mx8855/drivers/usb/dwc3/Kconfig
```kconfig
# SPDX-License-Identifier: GPL-2.0
#
# SEC USB Gadget support on a system involves
#
config SEC_USB_HOOK
	tristate "Exynos SoC series is mapping to sec usb function"
	depends on SEC_USB_CB
	help
	 Enable Sec HOOK CB to support for SEC function.
	 This driver provides OWN sec function to SOC series.
	 If you choose to build this driver is a dynamically linked
	 module, the module will be called sec_usb_hook.ko.
```

## device/mx/mx8855/drivers/usb/gadget/function/Kconfig
```kconfig
# SPDX-License-Identifier: GPL-2.0
#
# SEC USB Gadget support on a system involves
#
config USB_F_CONN_GADGET
	tristate

config USB_F_SS_MON_GADGET
	tristate

config USB_CONFIGFS_F_CONN_GADGET
	tristate "F_CONN gadget"
	depends on USB_CONFIGFS
	select USB_F_CONN_GADGET
	help
	  USB Sidesync function support

config USB_CONFIGFS_F_SS_MON_GADGET
	tristate "F_SAMSUNG gadget"
	select USB_F_SS_MON_GADGET
	help
	 Driver for control to Samsung Usb device layer
	 For Samung working scenario and saving debug log, etc
	 
```

## device/mx/mx8855/sound/soc/codecs/Kconfig
```kconfig
# SPDX-License-Identifier: GPL-2.0-only

menu "CODEC drivers"

config SND_SOC_ALL_CODECS
	tristate "Build all ASoC CODEC drivers"
	depends on COMPILE_TEST
	imply SND_SMARTPA_AW882XX
	help
	  Normally ASoC codec drivers are only built if a machine driver which
	  uses them is also built since they are only usable with a machine
	  driver.  Selecting this option will allow these drivers to be built
	  without an explicit machine driver for test and development purposes.


	  Support for the bus types used to access the codecs to be built must
	  be selected separately.

	  If unsure select "N".

config SND_SMARTPA_AW882XX
	tristate "SoC Audio for Awinic aw882xx series"
	depends on I2C
	help
	  This option enables support for aw882xx series Smart PA.
endmenu
```

## device/mx/mx8855/sound/soc/samsung/exynos/Kconfig
```kconfig
# SPDX-License-Identifier: GPL-2.0-only

config SND_SOC_SAMSUNG_EXYNOS_AW882XX
	tristate "AW882XX amp support on exynos"
	select SND_SMARTPA_AW882XX
	select SEC_SND_SYNCHRONIZED_IPC_AW

config SND_SOC_SAMSUNG_EXYNOS8855_AUDIO
	tristate "Sound card support on exynos8855 SEP"
	select SND_SOC_SAMSUNG_ABOX
	select SND_SOC_SAMSUNG_VTS
	select SND_SOC_SAMSUNG_MAILBOX
	select SND_SOC_SAMSUNG_SLIF

config SND_SOC_SAMSUNG_EXYNOS_TAS25XX
	tristate "TAS25XX amp support on exynos"
	select SND_SOC_TAS25XX
	select TAS25XX_ALGO
	select TAS25XX_CALIB_VAL_BIG
	select SEC_SND_SYNCHRONIZED_IPC_TI
	select PLATFORM_EXYNOS
	select FW_LOADER_USER_HELPER_FALLBACK
	select TAS25XX_MISC
	select TAS25XX_IRQ_BD

source "$(KCONFIG_EXT_SOC_PREFIX)sound/soc/samsung/exynos/abox/Kconfig"
source "$(KCONFIG_EXT_SOC_PREFIX)sound/soc/samsung/exynos/vts/Kconfig"
source "$(KCONFIG_EXT_SOC_PREFIX)sound/soc/samsung/exynos/slif/Kconfig"
source "$(KCONFIG_EXT_SOC_PREFIX)sound/soc/codecs/Kconfig"
```
