/*
 * SAMSUNG S5E8855 board device tree source
 *
 * Copyright (c) 2023 Samsung Electronics Co., Ltd.
 *		http://www.samsung.com
 *
 * This program is free software; you can redistribute it and/or modify
 * it under the terms of the GNU General Public License version 2 as
 * published by the Free Software Foundation.
 */

#include "s5e8855-gts10fep_common.dtsi"
#include <dt-bindings/gpio/gpio.h>
#include "panel/samsung-s6e3had-1080-2400-command-panel.dtsi"

/ {
	compatible = "samsung,s5e8855", "samsung,ERD8855";

	fragment@model {
		target-path = "/";
		__overlay__ {
			#address-cells = <2>;
			#size-cells = <1>;

			model = "Samsung S5E8855 board based on ERD8855";
		}; /* end of __overlay__ */
	}; /* end of fragment */
}; /* end of root */

&serial_0 {
	status = "okay";
};

