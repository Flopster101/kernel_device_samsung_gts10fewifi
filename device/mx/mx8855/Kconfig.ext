## device/mx/mx8855/Kconfig.ext
```kconfig
source "$(KCONFIG_EXT_SOC_PREFIX)Kconfig.ext"

source "$(KCONFIG_EXT_PREFIX)Kconfig.ext_modules"

source "$(KCONFIG_EXT_PREFIX)drivers/samsung/Kconfig"
source "$(KCONFIG_EXT_PREFIX)sound/soc/codecs/Kconfig"
source "$(KCONFIG_EXT_PREFIX)sound/soc/codecs/tas25xx/Kconfig"
source "$(KCONFIG_EXT_PREFIX)sound/soc/samsung/exynos/Kconfig"
source "$(KCONFIG_EXT_PREFIX)sound/soc/samsung/exynos/abox/Kconfig"
source "$(KCONFIG_EXT_PREFIX)drivers/tee/tzdev/Kconfig"
source "$(KCONFIG_EXT_PREFIX)drivers/tee/tui/Kconfig"
source "$(KCONFIG_EXT_PREFIX)drivers/ufs/Kconfig"
source "$(KCONFIG_EXT_PREFIX)drivers/mmc/Kconfig"
source "$(KCONFIG_EXT_PREFIX)drivers/usb/gadget/function/Kconfig"
source "$(KCONFIG_EXT_PREFIX)drivers/camera/Kconfig"
source "$(KCONFIG_EXT_PREFIX)drivers/leds/Kconfig"
source "$(KCONFIG_EXT_PREFIX)block/Kconfig"
source "$(KCONFIG_EXT_PREFIX)drivers/usb/dwc3/Kconfig"
source "$(KCONFIG_EXT_PREFIX)drivers/usb/misc/Kconfig"
source "$(KCONFIG_EXT_PREFIX)drivers/sec_panel_notifier_v2/Kconfig" # ADDED BY LEGO AUTOMATICALLY: DO NOT SUBMIT
source "$(KCONFIG_EXT_PREFIX)drivers/gpu/drm/samsung/panel/tft_common/Kconfig" # ADDED BY LEGO AUTOMATICALLY: DO NOT SUBMIT
source "$(KCONFIG_EXT_PREFIX)drivers/gpu/drm/samsung/panel/tft_common/kunit_test/Kconfig" # ADDED BY LEGO AUTOMATICALLY: DO NOT SUBMIT
source "$(KCONFIG_EXT_PREFIX)drivers/input/sec_input/Kconfig" # ADDED BY LEGO AUTOMATICALLY: DO NOT SUBMIT
source "$(KCONFIG_EXT_PREFIX)drivers/misc/drb/Kconfig" # ADDED BY LEGO AUTOMATICALLY: DO NOT SUBMIT
source "$(KCONFIG_EXT_PREFIX)drivers/muic/common/Kconfig" # ADDED BY LEGO AUTOMATICALLY: DO NOT SUBMIT
source "$(KCONFIG_EXT_PREFIX)drivers/samsung/factory/Kconfig" # ADDED BY LEGO AUTOMATICALLY: DO NOT SUBMIT
source "$(KCONFIG_EXT_PREFIX)drivers/knox/ngksm/Kconfig" # ADDED BY LEGO AUTOMATICALLY: DO NOT SUBMIT
source "$(KCONFIG_EXT_PREFIX)drivers/sti/common/Kconfig" # ADDED BY LEGO AUTOMATICALLY: DO NOT SUBMIT
source "$(KCONFIG_EXT_PREFIX)drivers/usb/notify/Kconfig" # ADDED BY LEGO AUTOMATICALLY: DO NOT SUBMIT
source "$(KCONFIG_EXT_PREFIX)drivers/dpu/panel/Kconfig" # ADDED BY LEGO AUTOMATICALLY: DO NOT SUBMIT
source "$(KCONFIG_EXT_PREFIX)drivers/battery/core/Kconfig" # ADDED BY LEGO AUTOMATICALLY: DO NOT SUBMIT
source "$(KCONFIG_EXT_PREFIX)drivers/staging/android/switch/Kconfig" # ADDED BY LEGO AUTOMATICALLY: DO NOT SUBMIT
source "$(KCONFIG_EXT_PREFIX)drivers/knox/hdm/Kconfig" # ADDED BY LEGO AUTOMATICALLY: DO NOT SUBMIT
source "$(KCONFIG_EXT_PREFIX)drivers/phy/common/Kconfig" # ADDED BY LEGO AUTOMATICALLY: DO NOT SUBMIT
source "$(KCONFIG_EXT_PREFIX)drivers/usb/common/vbus_notifier/Kconfig" # ADDED BY LEGO AUTOMATICALLY: DO NOT SUBMIT
source "$(KCONFIG_EXT_PREFIX)drivers/usb/typec/manager/Kconfig" # ADDED BY LEGO AUTOMATICALLY: DO NOT SUBMIT
source "$(KCONFIG_EXT_PREFIX)drivers/fingerprint/Kconfig" # ADDED BY LEGO AUTOMATICALLY: DO NOT SUBMIT
source "$(KCONFIG_EXT_PREFIX)drivers/knox/kzt/Kconfig" # ADDED BY LEGO AUTOMATICALLY: DO NOT SUBMIT
source "$(KCONFIG_EXT_PREFIX)drivers/battery/charger/sm5714_charger/Kconfig" # ADDED BY LEGO AUTOMATICALLY: DO NOT SUBMIT
source "$(KCONFIG_EXT_PREFIX)drivers/input/input_boost/Kconfig" # ADDED BY LEGO AUTOMATICALLY: DO NOT SUBMIT
source "$(KCONFIG_EXT_PREFIX)drivers/lego/Kconfig" # ADDED BY LEGO AUTOMATICALLY: DO NOT SUBMIT
source "$(KCONFIG_EXT_PREFIX)drivers/gpu/drm/Kconfig" # ADDED BY LEGO AUTOMATICALLY: DO NOT SUBMIT
source "$(KCONFIG_EXT_PREFIX)drivers/gpu/drm/samsung/panel/Kconfig" # ADDED BY LEGO AUTOMATICALLY: DO NOT SUBMIT
source "$(KCONFIG_EXT_PREFIX)drivers/phy/nxp/ptn3222/Kconfig" # ADDED BY LEGO AUTOMATICALLY: DO NOT SUBMIT
source "$(KCONFIG_EXT_PREFIX)drivers/usb/typec/common/Kconfig" # ADDED BY LEGO AUTOMATICALLY: DO NOT SUBMIT
source "$(KCONFIG_EXT_PREFIX)drivers/sti/abc/Kconfig" # ADDED BY LEGO AUTOMATICALLY: DO NOT SUBMIT
source "$(KCONFIG_EXT_PREFIX)drivers/phy/ti/tusb2e11/Kconfig" # ADDED BY LEGO AUTOMATICALLY: DO NOT SUBMIT
source "$(KCONFIG_EXT_PREFIX)drivers/mfd/sm/sm5714/Kconfig" # ADDED BY LEGO AUTOMATICALLY: DO NOT SUBMIT
source "$(KCONFIG_EXT_PREFIX)drivers/input/touchscreen/himax/hx83xxx_spi/Kconfig" # ADDED BY LEGO AUTOMATICALLY: DO NOT SUBMIT
source "$(KCONFIG_EXT_PREFIX)drivers/input/touchscreen/novatek/nt36523_tablet_spi/Kconfig" # ADDED BY LEGO AUTOMATICALLY: DO NOT SUBMIT
source "$(KCONFIG_EXT_PREFIX)drivers/input/misc/hall/Kconfig" # ADDED BY LEGO AUTOMATICALLY: DO NOT SUBMIT
source "$(KCONFIG_EXT_PREFIX)drivers/sensors_lego/Kconfig" # ADDED BY LEGO AUTOMATICALLY: DO NOT SUBMIT
source "$(KCONFIG_EXT_PREFIX)drivers/sensorhub/vendor/Kconfig" # ADDED BY LEGO AUTOMATICALLY: DO NOT SUBMIT
source "$(KCONFIG_EXT_PREFIX)drivers/battery/charger/sm5440_charger/Kconfig" # ADDED BY LEGO AUTOMATICALLY: DO NOT SUBMIT
source "$(KCONFIG_EXT_PREFIX)drivers/input/wacom/Kconfig" # ADDED BY LEGO AUTOMATICALLY: DO NOT SUBMIT
source "$(KCONFIG_EXT_PREFIX)drivers/battery/fuelgauge/sm5714_fuelgauge/Kconfig" # ADDED BY LEGO AUTOMATICALLY: DO NOT SUBMIT
source "$(KCONFIG_EXT_PREFIX)drivers/samsung/pm/sec_thermistor/Kconfig" # ADDED BY LEGO AUTOMATICALLY: DO NOT SUBMIT
source "$(KCONFIG_EXT_PREFIX)drivers/battery/battery_auth/ds28e30/Kconfig" # ADDED BY LEGO AUTOMATICALLY: DO NOT SUBMIT
source "$(KCONFIG_EXT_PREFIX)drivers/battery/common/Kconfig" # ADDED BY LEGO AUTOMATICALLY: DO NOT SUBMIT
source "$(KCONFIG_EXT_PREFIX)drivers/sensorhub/Kconfig" # ADDED BY LEGO AUTOMATICALLY: DO NOT SUBMIT
source "$(KCONFIG_EXT_PREFIX)drivers/sensorhub/debug/Kconfig" # ADDED BY LEGO AUTOMATICALLY: DO NOT SUBMIT
source "$(KCONFIG_EXT_PREFIX)drivers/sensorhub/sensor/Kconfig" # ADDED BY LEGO AUTOMATICALLY: DO NOT SUBMIT
source "$(KCONFIG_EXT_PREFIX)drivers/sensorhub/sensorhub/Kconfig" # ADDED BY LEGO AUTOMATICALLY: DO NOT SUBMIT
source "$(KCONFIG_EXT_PREFIX)drivers/nfc/snvm/Kconfig" # ADDED BY LEGO AUTOMATICALLY: DO NOT SUBMIT
source "$(KCONFIG_EXT_PREFIX)drivers/input/sec_input/stm32/Kconfig" # ADDED BY LEGO AUTOMATICALLY: DO NOT SUBMIT
source "$(KCONFIG_EXT_PREFIX)drivers/battery/battery_auth/sle956681/Kconfig" # ADDED BY LEGO AUTOMATICALLY: DO NOT SUBMIT
source "$(KCONFIG_EXT_PREFIX)drivers/usb/typec/sm/sm5714/Kconfig" # ADDED BY LEGO AUTOMATICALLY: DO NOT SUBMIT
source "$(KCONFIG_EXT_PREFIX)drivers/muic/sm/sm5714/Kconfig" # ADDED BY LEGO AUTOMATICALLY: DO NOT SUBMIT
```

## device/mx/mx8855/arch/arm64/configs/gts10fewifixx_00_defconfig
```kconfig
CONFIG_SND_SOC_SAMSUNG_EXYNOS8855_AUDIO=m
CONFIG_SND_SOC_SAMSUNG_AUDIO=m
CONFIG_SND_SOC_SAMSUNG_ABOX_CHANGE_RMEM_SIZE=y
CONFIG_SND_SOC_SAMSUNG_EXYNOS_TAS25XX=m
CONFIG_DRM_MCD_COMMON=y
CONFIG_USDM_PANEL=m
CONFIG_USDM_PANEL_DISPLAY_MODE=y
CONFIG_USDM_PANEL_DPUI=y
CONFIG_USDM_PANEL_JSON=y
CONFIG_USDM_BLIC_I2C=y
CONFIG_USDM_PANEL_BLIC=y
CONFIG_USDM_PANEL_ID_READ_REG_DADBDC=y
# CONFIG_TRUSTONIC_TEE is not set
# CONFIG_TRUSTONIC_TRUSTED_UI is not set
# CONFIG_SECURE_OS_CONTROL is not set
# CONFIG_SECURE_OS_BOOSTER_API is not set
# CONFIG_TZ_NWFS is not set
# CONFIG_TZDEV_BOOST is not set
# CONFIG_ION_FD2PHYS is not set
# CONFIG_TZDEV_DEPLOY_TZAR is not set
# CONFIG_TZDEV_TEST is not set
# CONFIG_TZDEV_CPUFREQ_TRANSITION is not set
CONFIG_TZDEV_USE_ARM_CALLING_CONVENTION=y
CONFIG_TZDEV=m
CONFIG_TZDEV_IWI_EVENT=260
CONFIG_TZDEV_IWI_PANIC=261
CONFIG_TZIRS=y
CONFIG_TZLOG=y
CONFIG_TZLOG_PG_CNT=8
CONFIG_TZ_BOOT_LOG=y
CONFIG_TZ_BOOT_LOG_PG_CNT=1
CONFIG_TZ_TRANSPORT=y
CONFIG_TZ_TRANSPORT_PG_CNT=2
CONFIG_TZDEV_SWD_PANIC_IS_CRITICAL=y
CONFIG_TEEGRIS_VERSION=6
CONFIG_SAMSUNG_GKI_KERNEL=y
CONFIG_TZDEV_SK_MULTICORE=y
CONFIG_SAMSUNG_TUI=m
CONFIG_SAMSUNG_TUI_LOWLEVEL=y
CONFIG_CAMERA_STY_V50=y
CONFIG_CAMERA_VENDOR_MCD=y
CONFIG_CAMERA_CIS_OV13A10_OBJ=m
CONFIG_CAMERA_CIS_HI1337_OBJ=m
CONFIG_CAMERA_ACT_DW9808_OBJ=m
```

## device/mx/mx8855/arch/arm64/configs/lego_defconfig
```kconfig
CONFIG_SEC_PANEL_NOTIFIER_V2=m
CONFIG_SEC_BOOTSTAT=m
CONFIG_SEC_KEY_NOTIFIER=m
# CONFIG_SEC_KN_WATCH is not set
CONFIG_CRASH_KEY_USER=m
CONFIG_HARD_RESET_HOOK=m
CONFIG_SEC_DEBUG=m
CONFIG_USDM_PANEL_TFT_COMMON=m
CONFIG_USDM_PANEL_HX83102J_GTS10FE_BOE=m
CONFIG_INPUT_SEC_INPUT=m
CONFIG_INPUT_SEC_NOTIFIER=m
CONFIG_SEC_DEBUG_TSP_LOG=m
CONFIG_TOUCHSCREEN_DUMP_MODE=m
CONFIG_SEC_INPUT_HEADER=y
# CONFIG_INPUT_SEC_SECURE_TOUCH is not set
# CONFIG_INPUT_SEC_TRUSTED_TOUCH is not set
# CONFIG_INPUT_TOUCHSCREEN_TCLMV2 is not set
# CONFIG_SEC_INPUT_MULTI_DEVICE is not set
# CONFIG_SEC_INPUT_RAWDATA is not set
CONFIG_DEV_RIL_BRIDGE=m
CONFIG_MUIC_NOTIFIER=m
CONFIG_HICCUP_CC_DISABLE=y
CONFIG_HICCUP_CHARGER=y
CONFIG_MUIC_COMMON_SYSFS=y
CONFIG_MUIC_AFC_RETRY=y
CONFIG_MUIC_HV=y
CONFIG_MUIC_SUPPORT_PDIC=y
CONFIG_MUIC_USE_MODULE_PARAM=y
CONFIG_USE_MUIC=y
CONFIG_SEC_RELOC_GPIO=m
CONFIG_SEC_REBOOT=m
CONFIG_NGKSM=m
CONFIG_NGKPAD=m
CONFIG_NGKSM_EXYNOS=y
CONFIG_DRV_SAMSUNG=m
CONFIG_SEC_STI=y
CONFIG_USB_NOTIFY_LAYER=m
CONFIG_USB_DEBUG_DETAILED_LOG=y
CONFIG_USB_EXTERNAL_NOTIFY=y
CONFIG_USB_HMT_SAMSUNG_INPUT=y
CONFIG_USB_HOST_NOTIFY=y
CONFIG_USB_HOST_SAMSUNG_FEATURE=y
CONFIG_USB_HW_PARAM=y
CONFIG_USB_INTERFACE_LPM_LIST=y
CONFIG_USB_NOTIFY_PROC_LOG=y
CONFIG_USB_USING_ADVANCED_USBLOG=y
CONFIG_USDM_PANEL_NT36523N_GTS10FE_CSOT=m
CONFIG_SB_CORE=m
CONFIG_SB_PQUEUE=y
CONFIG_SB_NOTIFY=y
CONFIG_SB_SYSFS=y
CONFIG_SB_VOTE=y
CONFIG_ANDROID_SWITCH=m
# CONFIG_ANDROID_SWITCH_GPIO is not set
CONFIG_HDM=m
CONFIG_HDM_EXYNOS=y
CONFIG_USB_REPEATER=m
CONFIG_VBUS_NOTIFIER=m
CONFIG_USB_TYPEC_MANAGER_NOTIFIER=m
CONFIG_IF_CB_MANAGER=m
CONFIG_SENSORS_FINGERPRINT=m
CONFIG_KZT=m
CONFIG_CHARGER_SM5714=m
CONFIG_SHIPMODE_BY_VBAT=y
CONFIG_SEC_ABC_SPEC_TYPE1=m
CONFIG_SEC_INPUT_BOOSTER=m
CONFIG_SEC_INPUT_BOOSTER_MODE=y
CONFIG_SEC_INPUT_BOOSTER_SLSI=y
CONFIG_SEC_INPUT_BOOSTER_HANDLER=y
CONFIG_HELLO_LEGO=m
CONFIG_DRM_PANEL_MCD_COMMON=m
# CONFIG_DRM_PANEL_SAMSUNG_COMMON is not set
CONFIG_USDM_PANEL_JSON=y
CONFIG_USB_REPEATER_PTN3222=m
CONFIG_PDIC_NOTIFIER=m
CONFIG_PDIC_USE_MODULE_PARAM=y
CONFIG_SEC_ABC=m
CONFIG_SEC_ABC_HUB=m
CONFIG_SEC_ABC_COMMON=m
CONFIG_SEC_ABC_HUB_CORE=m
CONFIG_SEC_ABC_HUB_BOOTC=m
CONFIG_SEC_ABC_MOTTO=m
CONFIG_USB_NOTIFIER=m
CONFIG_SENSORS_GW3X=m
CONFIG_SENSORS_FINGERPRINT_MODULE=y
CONFIG_FINGERPRINT_SECURE=y
CONFIG_SENSORS_FINGERPRINT_LSI=y
# CONFIG_SENSORS_FINGERPRINT_NORMALSPI is not set
# CONFIG_SENSORS_FINGERPRINT_32BITS_PLATFORM_ONLY is not set
CONFIG_USB_REPEATER_TUSB2E11=m
CONFIG_MFD_SM5714=m
CONFIG_TOUCHSCREEN_HIMAX_HX83XXX_SPI=m
CONFIG_TOUCHSCREEN_HIMAX_IC_HX83102=m
# CONFIG_TOUCHSCREEN_HIMAX_IC_HX83108 is not set
# CONFIG_TOUCHSCREEN_HIMAX_IC_HX83112 is not set
# CONFIG_TOUCHSCREEN_HIMAX_IC_HX83121 is not set
# CONFIG_TOUCHSCREEN_HIMAX_IC_HX83122 is not set
# CONFIG_TOUCHSCREEN_HIMAX_IC_HX83123 is not set
CONFIG_TOUCHSCREEN_HIMAX_ZERO_FLASH=m
CONFIG_TOUCHSCREEN_NOVATEK_NT36523_TABLET_SPI=m
CONFIG_INPUT_HALL_IC=m
CONFIG_HALL_NOTIFIER=m
CONFIG_HALL_LOGICAL=m
# CONFIG_HALL_DUMP_KEY_MODE is not set
CONFIG_SENSORS_SUPPORT_SLSI=y
CONFIG_SENSORS_ISG6320=m
# CONFIG_SENSORS_ISG6320_SUB is not set
# CONFIG_SENSORS_ISG6320_SUB2 is not set
CONFIG_SENSORS_ISG6320_WIFI=y
CONFIG_TABLET_MODEL_CONCEPT=y
CONFIG_SENSORS_SKIP_CABLE_RESET=y
CONFIG_SENSORS_GRIP_FAILURE_DEBUG=y
CONFIG_NANOHUB=m
CONFIG_SENSOR_DRV=n
CONFIG_SHUB_MODULE=y
CONFIG_CHARGER_SM5440=m
CONFIG_REGULATOR_FIXED_VOLTAGE=y
CONFIG_EPEN_WACOM_WEZ01=m
CONFIG_FUELGAUGE_SM5714=m
CONFIG_SEC_PM_THERMISTOR=m
CONFIG_BATTERY_AUTH_DS28E30=m
CONFIG_DIRECT_CHARGING=m
CONFIG_IIO=y
CONFIG_IIO_BUFFER=y
CONFIG_SHUB=m
CONFIG_STAR_K250A_LEGO=m
CONFIG_SEC_SNVM_PLATFORM_DRV=y
# CONFIG_SEC_SNVM_I2C_CLOCK_CONTROL is not set
CONFIG_SEC_SNVM_WAKELOCK_METHOD=2
# CONFIG_STAR_MEMORY_LEAK is not set
CONFIG_KEYBOARD_STM32_POGO_V3=m
# CONFIG_KEYBOARD_STM32_POGO_USE_VOTING is not set
CONFIG_BATTERY_AUTH_SLE956681=m
CONFIG_PDIC_SM5714=m
CONFIG_SM5714_FACTORY_MODE=y
CONFIG_SM5714_WATER_DETECTION_ENABLE=y
CONFIG_SM5714_SUPPORT_SBU=y
CONFIG_PDIC_PD30=y
CONFIG_SUPPORT_USB_TYPEC_OPS=y
CONFIG_SM5714_NORMAL_DRP=y
CONFIG_MUIC_SM5714=m
CONFIG_MUIC_BCD_RESCAN=y
CONFIG_BATTERY_SAMSUNG=m
CONFIG_SEC_PD=m
CONFIG_BATTERY_GKI=y
CONFIG_BATTERY_AGE_FORECAST=y
CONFIG_BATTERY_CISD=y
CONFIG_AFC_CHARGER_MODE=y
CONFIG_BATTERY_LOGGING=y
CONFIG_BATTERY_SAMSUNG_REBOOT=y
CONFIG_ENABLE_FULL_BY_SOC=y
CONFIG_STEP_CHARGING=y
CONFIG_SUPPORT_HV_CTRL=y
CONFIG_SUPPORT_SHIP_MODE=y
```
