## soc-series/s-android15/drivers/clocksources/Kconfig
```kconfig
# SPDX-License-Identifier: GPL-2.0-only
config CLKSRC_EXYNOS_MCT_V3
	tristate "Exynos multi core timer (ver 3) driver"
	depends on ARM || ARM64
	help
	  Support for Multi Core Timer controller on Exynos SoCs.
```

## soc-series/s-android15/drivers/cpufreq/Kconfig
```kconfig
# SPDX-License-Identifier: GPL-2.0
#
# Samsung SoC drivers
#

config EXYNOS_CPUFREQ
	tristate "SAMSUNG EXYNOS CPUFreq driver"
	default n
	depends on ARCH_EXYNOS
	help
	  This adds the CPUFreq driver for every exynos chipset. Exynos CPUFreq
	  supported SoC must use the exynos CAL framework.

	  If in doubt, say N.

config FREQ_QOS_TRACER
	tristate "SAMSUNG CPUFreq QoS Tracer"
	depends on ARCH_EXYNOS
	help
	  This supports tracing function to figure out who requested QoS with
	  which value.

config EXYNOS_DSUFREQ
	tristate "SAMSUNG EXYNOS DSU Frequency driver"
	help
	  This adds the DSUFreq driver for specific exynos chipset. Exynos
	  DSUFreq supported SoC must use the exynos CAL framework.

	  If in doubt, say N.

config CPU_EXYNOS_KUNIT_TEST
	tristate "KUnit tests for CPU" if !KUNIT_ALL_TESTS
	depends on KUNIT
	depends on EXYNOS_CPUFREQ && EXYNOS_DSUFREQ
	default KUNIT_ALL_TESTS
```

## soc-series/s-android15/drivers/devfreq/Kconfig
```kconfig
if PM_DEVFREQ

config ARM_EXYNOS_DEVFREQ
	tristate "ARM Exynos Memory Bus DEVFREQ Common driver"
	depends on ARCH_EXYNOS
	select PM_OPP
	help
	  This adds the DEVFREQ driver for Exynos series common bus

config ARM_EXYNOS_DEVFREQ_DEBUG
	tristate "ARM Exynos DEVFREQ sysfs for Debug"
	depends on ARM_EXYNOS_DEVFREQ

config DVFS_EXYNOS_KUNIT_TEST
	tristate "Example test for Devfreq" if !KUNIT_ALL_TESTS
	depends on ARM_EXYNOS_DEVFREQ
	depends on KUNIT
	default KUNIT_ALL_TESTS

config EXYNOS_LEALT_DVFS
	tristate "Latency Evaluated Active Load Tracing (LEALT) DVFS"
	default n
	depends on ARM_EXYNOS_DEVFREQ
	help
	  Enable LEALT-DVFS governor for MIF domain.

endif
```

## soc-series/s-android15/drivers/dma-buf/heaps/samsung/Kconfig
```kconfig
# SPDX-License-Identifier: GPL-2.0
config DMABUF_SAMSUNG_HEAPS
	tristate "DMA-BUF Userland Memory Heaps for Samsung"
	select SAMSUNG_SECURE_IOVA
	select DMABUF_CONTAINER
	select DMABUF_HEAPS_PAGE_POOL
	select DMABUF_HEAPS_DEFERRED_FREE
	depends on DMABUF_HEAPS
	help
	  Choose this option to enable the DMA-BUF userland memory heaps for samsung.
	  This options creates per heap chardevs in /dev/dma_heap/* which allows
	  userspace to allocate dma-bufs that can be shared between drivers.

config DMABUF_HEAPS_SAMSUNG_PREALLOCATED_CHUNK
	bool "DMA-BUF PREALLOCATED CHUNK Samsung Heap"
	depends on DMABUF_SAMSUNG_HEAPS
	help
	  Choose this option to enable dma-buf PREALLOCATED CHUNK heap for samsung.
	  This heap is backed by the Contiguous Memory Allocator (CMA) and allocates
	  the buffers that are requested size chunks from CMA.

config DMABUF_HEAPS_SAMSUNG_CMA
	bool "DMA-BUF CMA Samsung Heap"
	depends on DMABUF_SAMSUNG_HEAPS
	help
	  Choose this option to enable dma-buf CMA heap for samsung.
	  This heap is backed by the Contiguous Memory Allocator (CMA) and have own
	  cma region by dt binding.

config DMABUF_HEAPS_SAMSUNG_CARVEOUT
	bool "DMA-BUF Carveout Samsung Heap"
	depends on DMABUF_SAMSUNG_HEAPS
	help
	  Choose this option to enable dma-buf Carveout heap for samsung.
	  This heap has own reserved region by dt binding.

config DMABUF_HEAPS_SAMSUNG_SECURE_SYSTEM
	bool "DMA-BUF System Secure Samsung Heap"
	depends on DMABUF_HEAPS_SAMSUNG_SYSTEM
	help
	  Choose this option to enable dma-buf Secure System heap for samsung.

config DMABUF_HEAPS_GOOGLE_GCMA
	bool "DMA-BUF GCMA Heap"
	depends on GCMA
	help
	  Choose this option to enable dma-buf GCMA heap. It allows
	  using the carved out memory space for clean page cache when memory
	  is not claimed by owner.
	  This heap has own reserved region by dt binding.

config DMABUF_HEAPS_SAMSUNG_SYSTEM
	bool "DMA-BUF System Samsung Heap"
	depends on DMABUF_SAMSUNG_HEAPS
	help
	  Choose this option to enable dma-buf System heap for samsung.

config DMABUF_CONTAINER
	tristate "Dma-buf container support"
	depends on DMA_SHARED_BUFFER
	help
	  dma-buf container is a dma-buf that can contain multiple different
	  dma-buf objects. It is useful when delivering a lot of dma-buf objects
	  between processes or user and kernel to reduce communication overhead.

config RBIN
	bool "DMA-BUF RBIN Samsung Heap"
	depends on DMABUF_SAMSUNG_HEAPS && CLEANCACHE
	default y
	help
	  Choose this option to enable dma-buf rbin heap for samsung.

config DMABUF_HEAPS_CAMERAPOOL
	bool "DMA-BUF Samsung camera pool heap"
	depends on DMABUF_SAMSUNG_HEAPS
	help
	  Choose this option to enable dma-buf camera pool heap for samsung.
	  Camera may pre-allocate memory on camera launch before allocating
	  dma buffer.
	  Pre-allocated memory should be freed on camera close.
```

## soc-series/s-android15/drivers/dpu/tests/Kconfig
```kconfig
config DPU_EXYNOS_KUNIT_TEST
	tristate "KUnit tests for DPU" if !KUNIT_ALL_TESTS
	depends on KUNIT
	depends on DRM_SAMSUNG_DPU
	default KUNIT_ALL_TESTS

config DPU_DSIM_BIST_KUNIT_TEST
	tristate "Support DSIM bist Test"
	select DPU_KUNIT_HELPER
	default n
	help
	  If this menu is enabled, you can test dsim bist at booting time.

config DPU_DECON_COLORMAP_KUNIT_TEST
	tristate "Support DECON colormap Test"
	select DPU_KUNIT_HELPER
	default n
	help
	  If this menu is enabled, you can test decon colormap at booting time.

config DPU_DMA_KUNIT_TEST
	tristate "Support DPU_DMA with dma buf Test"
	select DPU_KUNIT_HELPER
	default n
	help
	  If this menu is enabled, you can test DPU_DMA with dma buf at booting time.
```

## soc-series/s-android15/drivers/gud/Kconfig
```kconfig
#
# Mobicore Configuration
#
if SOC_S5E9945
source "$(KCONFIG_EXT_SOC_PREFIX)drivers/gud/gud-s5e9945/Kconfig"
endif
if SOC_S5E9955
source "$(KCONFIG_EXT_SOC_PREFIX)drivers/gud/gud-s5e9955/Kconfig"
endif
if SOC_S5E8855
source "$(KCONFIG_EXT_SOC_PREFIX)drivers/gud/gud-s5e8855/Kconfig"
endif
```

## soc-series/s-android15/drivers/i2c/busses/Kconfig
```kconfig
# SPDX-License-Identifier: GPL-2.0-only

comment "HSI2C Drivers"

config I2C_EXYNOS5_EXT
	tristate "Exynos high-speed I2C driver"
	depends on OF
	depends on ARCH_EXYNOS || COMPILE_TEST
	help
	  High-speed I2C controller on Samsung Exynos5 and newer Samsung SoCs

config I2C_EXYNOS5_EXT_KUNIT_TEST
	tristate "Kunit tests for Exynos high-speed I2C driver" if !KUNIT_ALL_TESTS
	depends on KUNIT
	depends on I2C_EXYNOS5_EXT
	default KUNIT_ALL_TESTS

config EXYNOS_ESCA_MFD_BUS
	tristate "SAMSUNG EXYNOS ESCA_MFD_BUS driver"
	depends on ARCH_EXYNOS && OF
	help
	  ESCA MFD BUS on Exynos based Samsung SoCs.
```

## soc-series/s-android15/drivers/iio/adc/Kconfig
```kconfig
# SPDX-License-Identifier: GPL-2.0-only
#
# SAMSUNG PMIC ADC drivers
#
# When adding new entries keep the list in alphabetical order

config ADC_S2P
	tristate "SAMSUNG ADC driver support for common"
	depends on MFD_S2P
	help
	  Core support for the ADC block found in the Samsung PMIC series
	  for drivers such as the touchscreen and hwmon to use to share
	  this resource.

	  To compile this driver as a module, choose M here: the module will be
	  called s2p_adc.

config S2MPS27_ADC
	tristate "S2MPS27 ADC driver support for 9945"
	depends on MFD_S2MPS27
	help
	  Core support for the ADC block found in the Samsung PMIC series
	  for drivers such as the touchscreen and hwmon to use to share
	  this resource.

	  To compile this driver as a module, choose M here: the module will be
	  called s2mps27_adc.

config S2SE910_ADC
	tristate "S2SE910 ADC driver support for S2SE910"
	depends on MFD_S2SE910
	help
	  Core support for the ADC block found in the Samsung PMIC series
	  for drivers such as the touchscreen and hwmon to use to share
	  this resource.

	  To compile this driver as a module, choose M here: the module will be
	  called s2se910_adc.

config S2RP910_ADC
	tristate "S2RP910 ADC driver support for S2RP910"
	depends on MFD_S2RP910
	help
	  Core support for the ADC block found in the Samsung PMIC series
	  for drivers such as the touchscreen and hwmon to use to share
	  this resource.

	  To compile this driver as a module, choose M here: the module will be
	  called s2rp910_adc.

config S2MPU15_ADC
	tristate "S2MPU15 ADC driver support for S2MPU15"
	depends on MFD_S2MPU15
	help
	  Core support for the ADC block found in the Samsung PMIC series
	  for drivers such as the touchscreen and hwmon to use to share
	  this resource.

	  To compile this driver as a module, choose M here: the module will be
	  called s2mpu15_adc.
```

## soc-series/s-android15/drivers/input/keyboard/Kconfig
```kconfig
# SPDX-License-Identifier: GPL-2.0-only
#
# Input core configuration
#

config KEYBOARD_S2P
        tristate "Samsung Electronics Key Controller for S.LSI Power Product"
	depends on I2C

config KEYBOARD_S2MPS27
	tristate "Samsung Electronics S2MPS27 Powerkey/Vol-down Controller"
	depends on I2C
	depends on MFD_S2MPS27

config KEYBOARD_S2SE910
	tristate "Samsung Electronics S2SE910 Powerkey/Vol-down Controller"
	depends on I2C
	depends on MFD_S2SE910

config KEYBOARD_S2MPU15
	tristate "Samsung Electronics S2MPU15 Powerkey/Vol-down Controller"
	depends on I2C
	depends on MFD_S2MPU15
```

## soc-series/s-android15/drivers/iommu/samsung/Kconfig
```kconfig
# SPDX-License-Identifier: GPL-2.0-only
config SAMSUNG_IOMMU
	tristate "Samsung IOMMU Support"
	select ARM_DMA_USE_IOMMU
	select IOMMU_DMA
	select SAMSUNG_IOMMU_GROUP
	help
	  Support for IOMMU on Samsung Exynos SoCs.

config SAMSUNG_IOMMU_GROUP
	tristate "Samsung IOMMU Group Support"
	help
	  Support for IOMMU group on Samsung Exynos SoCs.

config SAMSUNG_SECURE_IOVA
	tristate "Samsung Secure IOVA Support"
	help
	  Support secure device virtual address management for Samsung Exynos SoCs.

config SAMSUNG_IOMMU_V9
	tristate "Samsung IOMMU V9 Support"
	select ARM_DMA_USE_IOMMU
	select IOMMU_DMA
	select SAMSUNG_IOMMU_GROUP_V9
	help
	  Support for IOMMU V9 on Samsung Exynos SoCs.

config SAMSUNG_IOMMU_GROUP_V9
	tristate "Samsung IOMMU Group V9 Support"
	help
	  Support for IOMMU group on Samsung Exynos SoCs.

config SYSMMU_EXYNOS_KUNIT_TEST
	tristate "Samsung IOMMU KUNIT Test Support" if !KUNIT_ALL_TESTS
	depends on KUNIT
	depends on SAMSUNG_IOMMU_V9
	default KUNIT_ALL_TESTS
	help
	  Support for IOMMU KUNIT test on Samsung Exynos SoCs.

config EXYNOS_CPIF_IOMMU_V9
        tristate "Enable Exynos CPIF IOMMU for version 9"
        depends on EXYNOS_MODEM_IF
        help
          enable IOMMU V9 feature for Exynos CPIF

config EXYNOS_PCIE_IOMMU
        tristate "Enable Exynos PCIe IOMMU"
        depends on PCI_EXYNOS_HOST
        help
          enable IOMMU feature for Exynos PCIe
```

## soc-series/s-android15/drivers/mfd/Kconfig
```kconfig
# SPDX-License-Identifier: GPL-2.0-only
#
# Multifunction miscellaneous devices for samsung pmic
#

config MFD_S2P
	tristate "SAMSUNG Electronics S2P PMIC Series Support"
	depends on I2C=y
	select MFD_CORE
	select REGULATOR
	help
	  Support for the Samsung Electronics MFD series.
	  This driver provides common support for accessing the device,
	  additional drivers must be enabled in order to use the functionality
	  of the device

config MFD_S2MPS27
	tristate "SAMSUNG Electronics S2MPS27 PMIC Series Support for s5e9945"
	depends on I2C=y
	select MFD_CORE
	select REGULATOR
	help
	  Support for the Samsung Electronics MFD series.
	  This driver provides common support for accessing the device,
	  additional drivers must be enabled in order to use the functionality
	  of the device

config MFD_S2MPS28
	tristate "SAMSUNG Electronics S2MPS28 PMIC Series Support for s5e9945"
	depends on I2C=y
	select MFD_CORE
	select REGULATOR
	help
	  Support for the Samsung Electronics MFD series.
	  This driver provides common support for accessing the device,
	  additional drivers must be enabled in order to use the functionality
	  of the device

config MFD_S2MPM07
	tristate "SAMSUNG Electronics S2MPM07 PMIC Series Support for s5e9945"
	depends on I2C=y
	select MFD_CORE
	select REGULATOR
	help
	  Support for the Samsung Electronics MFD series.
	  This driver provides common support for accessing the device,
	  additional drivers must be enabled in order to use the functionality
	  of the device

config MFD_S2MPA05
	tristate "SAMSUNG Electronics S2MPA05 PMIC Series Support for s5e9945"
	depends on I2C=y
	select MFD_CORE
	select REGULATOR
	help
	  Support for the Samsung Electronics MFD series.
	  This driver provides common support for accessing the device,
	  additional drivers must be enabled in order to use the functionality
	  of the device

config MFD_S2MPB02
	tristate "Samsung Semiconductor S2MPB02 PMIC Support"
	depends on I2C=y
	select MFD_CORE
	help
	  Say yes here to support for Samsung Semiconductor S2MPB02.
	  This is a Power Management IC with Flash on chip.
	  This driver provides common support for accessing the device;
	  additional drivers

config MFD_S2SE910
	tristate "SAMSUNG Electronics S2SE910 PMIC Series Support for soc"
	depends on I2C=y
	select MFD_CORE
	select REGULATOR
	help
	  Support for the Samsung Electronics MFD series.
	  This driver provides common support for accessing the device,
	  additional drivers must be enabled in order to use the functionality
	  of the device

config MFD_S2SE911
	tristate "SAMSUNG Electronics S2SE911 PMIC Series Support for soc"
	depends on I2C=y
	select MFD_CORE
	select REGULATOR
	help
	  Support for the Samsung Electronics MFD series.
	  This driver provides common support for accessing the device,
	  additional drivers must be enabled in order to use the functionality
	  of the device

config MFD_S2RP910
	tristate "SAMSUNG Electronics S2RP910 PMIC Series Support for soc"
	depends on I2C=y
	select MFD_CORE
	select REGULATOR
	help
	  Support for the Samsung Electronics MFD series.
	  This driver provides common support for accessing the device,
	  additional drivers must be enabled in order to use the functionality
	  of the device

config MFD_S2MPU15
	tristate "SAMSUNG Electronics S2MPU15 PMIC Series Support for soc"
	depends on I2C=y
	select MFD_CORE
	select REGULATOR
	help
	  Support for the Samsung Electronics MFD series.
	  This driver provides common support for accessing the device,
	  additional drivers must be enabled in order to use the functionality
	  of the device

config MFD_S2MPU16
	tristate "SAMSUNG Electronics S2MPU16 PMIC Series Support for soc"
	depends on I2C=y
	select MFD_CORE
	select REGULATOR
	help
	  Support for the Samsung Electronics MFD series.
	  This driver provides common support for accessing the device,
	  additional drivers must be enabled in order to use the functionality
	  of the device
```

## soc-series/s-android15/drivers/misc/samsung/Kconfig
```kconfig
source "$(KCONFIG_EXT_SOC_PREFIX)drivers/misc/samsung/gpio_debug/Kconfig"
if SOC_S5E9955
source "$(KCONFIG_EXT_SOC_PREFIX)drivers/misc/samsung/pcie_scsc/Kconfig"
endif
if SOC_S5E8855
source "$(KCONFIG_EXT_SOC_PREFIX)drivers/misc/samsung/scsc/Kconfig"
endif
source "$(KCONFIG_EXT_SOC_PREFIX)drivers/misc/samsung/scsc_bt/Kconfig"
source "$(KCONFIG_EXT_SOC_PREFIX)drivers/misc/samsung/slsi_bt/Kconfig"
source "$(KCONFIG_EXT_SOC_PREFIX)drivers/misc/samsung/kic/Kconfig"
source "$(KCONFIG_EXT_SOC_PREFIX)drivers/misc/samsung/hardening/Kconfig"
```
