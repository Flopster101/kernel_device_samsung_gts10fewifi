## soc-series/s-android15/drivers/regulator/Kconfig
```kconfig
# SPDX-License-Identifier: GPL-2.0
# SAMSUNG PMIC

config REGULATOR_SAMSUNG_PMIC
	tristate "Samsung PMIC regulator"
	depends on I2C
	help
	 This driver supports a Samsung PMIC regulator.

config DRV_SAMSUNG_PMIC
	tristate "Samsung PMIC common and sysfs system"
	depends on MFD_S2P
	help
	 This driver supports a Samsung PMIC sysfs amd common.

config REGULATOR_S2P
	tristate "Samsung PMIC common parts"
	depends on MFD_S2P
	help
	 This driver supports a Samsung PMIC common.

config REGULATOR_S2MPS27
	tristate "Samsung S2MPS27 voltage regulator for s5e9945"
	depends on MFD_S2MPS27
	help
	  This driver supports a Samsung S2MPS27 voltage output regulator
	  via SPMI bus. S2MPS27 is comprised of high efficient Buck converters
	  including Dual-Phase Buck converter, Buck-Boost converter, various LDOs.

config REGULATOR_S2MPS28
	tristate "Samsung S2MPS28 voltage regulator for s5e9945"
	depends on MFD_S2MPS28
	help
	  This driver supports a Samsung S2MPS28 voltage output regulator
	  via SPMI bus. S2MPS28 is comprised of high efficient Buck converters
	  including Dual-Phase Buck converter, Buck-Boost converter, various LDOs.

config REGULATOR_S2MPM07
	tristate "Samsung S2MPM07 voltage regulator for s5e9945"
	depends on MFD_S2MPM07
	help
	  This driver supports a Samsung S2MPM07 voltage output regulator
	  via SPMI bus. S2MPM07 is comprised of high efficient Buck converters
	  including Dual-Phase Buck converter, Buck-Boost converter, various LDOs.

config REGULATOR_S2MPA05
	tristate "Samsung S2MPA05 voltage regulator for s5e9945"
	depends on MFD_S2MPA05
	help
	  This driver supports a Samsung S2MPA05 voltage output regulator
	  via SPMI bus. S2MPA05 is comprised of high efficient Buck converters
	  including Dual-Phase Buck converter, Buck-Boost converter, various LDOs.

config REGULATOR_S2MPB02
	tristate "Samsung S2MPB02 regulator"
	depends on MFD_S2MPB02
	help
	  This driver controls a Samsung S2MPB02 regulator
	  via I2C bus.

config REGULATOR_S2MPB03
	tristate "Samsung S2MPB03 regulator"
	depends on I2C
	help
	  This driver controls a Samsung S2MPB03 regulator
	  via I2C bus.

config REGULATOR_S2DOS05
	tristate "Samsung S2DOS05 regulator"
	depends on I2C
	help
	  This driver controls a Samsung S2DOS05 regulator
	  via I2C bus.

config REGULATOR_S2DOS07
	tristate "Samsung S2DOS07 regulator"
	depends on I2C
	help
	  This driver controls a Samsung S2DOS07 regulator
	  via I2C bus.

config REGULATOR_S2SE910
	tristate "Samsung S2SE910 voltage regulator for soc"
	depends on MFD_S2SE910
	help
	  This driver supports a Samsung S2SE910 voltage output regulator
	  via SPMI bus. S2SE910 is comprised of high efficient Buck converters
	  including Dual-Phase Buck converter, Buck-Boost converter, various LDOs.

config REGULATOR_S2SE911
	tristate "Samsung S2SE911 voltage regulator for soc"
	depends on MFD_S2SE911
	help
	  This driver supports a Samsung S2SE911 voltage output regulator
	  via SPMI bus. S2SE911 is comprised of high efficient Buck converters
	  including Dual-Phase Buck converter, Buck-Boost converter, various LDOs.

config REGULATOR_S2RP910
	tristate "Samsung S2SE911 voltage regulator for soc"
	depends on MFD_S2RP910
	help
	  This driver supports a Samsung S2RP910 voltage output regulator
	  via SPMI bus. S2RP910 is comprised of high efficient Buck converters
	  including Dual-Phase Buck converter, Buck-Boost converter, various LDOs.

config REGULATOR_S2MPU15
	tristate "Samsung S2MPU15 voltage regulator for soc"
	depends on MFD_S2MPU15
	help
	  This driver supports a Samsung S2MPU15 voltage output regulator
	  via SPMI bus. S2MPU15 is comprised of high efficient Buck converters
	  including Dual-Phase Buck converter, Buck-Boost converter, various LDOs.

config REGULATOR_S2MPU16
	tristate "Samsung S2MPU16 voltage regulator for soc"
	depends on MFD_S2MPU16
	help
	  This driver supports a Samsung S2MPU16 voltage output regulator
	  via SPMI bus. S2MPU16 is comprised of high efficient Buck converters
	  including Dual-Phase Buck converter, Buck-Boost converter, various LDOs.
```

## soc-series/s-android15/drivers/repeater/Kconfig
```kconfig
config VIDEO_EXYNOS_REPEATER
		tristate "EXYNOS REPEATER Driver"
		default n
		help
		  Repeater driver for WFD
```

## soc-series/s-android15/drivers/rtc/Kconfig
```kconfig
# SPDX-License-Identifier: GPL-2.0-only
#
# PMIC RTC class/drivers configuration
#

config RTC_S2P
	tristate "Samsung PMIC RTC"
	depends on MFD_S2P
	help
	  If you say yes here you will get support for the
	  RTC of Samsung PMIC series.
	  This driver can also be built as a module. If so, the module
	  will be called s2p_rtc.

config RTC_S2MPS27
	tristate "Samsung PMIC RTC for 9945"
	depends on MFD_S2MPS27
	help
	  If you say yes here you will get support for the
	  RTC of Samsung PMIC series.
	  This driver can also be built as a module. If so, the module
	  will be called rtc-s2mps27.

config RTC_S2SE910
	tristate "Samsung PMIC RTC for S2SE910"
	depends on MFD_S2SE910
	help
	  If you say yes here you will get support for the
	  RTC of Samsung PMIC series.
	  This driver can also be built as a module. If so, the module
	  will be called s2se910_rtc.

config RTC_S2MPU15
	tristate "Samsung PMIC RTC for S2MPU15"
	depends on MFD_S2MPU15
	help
	  If you say yes here you will get support for the
	  RTC of Samsung PMIC series.
	  This driver can also be built as a module. If so, the module
	  will be called s2mpu15_rtc.

config RTC_AUTO_PWRON
	tristate "RTC Auto Power on PMICs"
	default n
	depends on SEC_PM
	help
	  Support for the auto power on alarm on the PMIC.
```

## soc-series/s-android15/drivers/scaler/Kconfig
```kconfig
config VIDEO_EXYNOS_SCALER
       tristate "EXYNOS M2M Scaler Driver"
       depends on VIDEO_DEV && HAS_DMA
       depends on ARCH_EXYNOS
       select V4L2_MEM2MEM_DEV
       select VIDEOBUF2_DMA_SG
       default n
       help
         This is a v4l2 driver for EXYNOS Scaler (MSCL) device.

config MSCL_EXYNOS_KUNIT_TEST
	tristate "KUnit tests for MSCL" if !KUNIT_ALL_TESTS
	depends on KUNIT
	depends on VIDEO_EXYNOS_SCALER
	default KUNIT_ALL_TESTS
```
