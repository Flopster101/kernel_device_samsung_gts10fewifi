## soc-series/s-android15/drivers/misc/samsung/scsc_bt/Kconfig
```kconfig
config SCSC_BT
	tristate "SCSC MX BT support"
	depends on (SCSC_CORE || SCSC_BT_KUNIT_TEST)

config SCSC_BT_BLUEZ
	default N
	tristate "SCSC MX BlueZ support"
	depends on SCSC_CORE

config SCSC_ANT
	default N
	tristate "SCSC MX ANT support"
	depends on SCSC_CORE
	depends on !CONFIG_SCSC_INDEPENDENT_SUBSYSTEM
	help
	  This module adds support for using a ANT character device.

config SCSC_BT_ADDRESS_IN_FILE
	default N
	tristate "SCSC MX BT support"
	depends on SCSC_CORE
	help
	  Allow BT address to be read from a file

config SCSC_BT_ADDRESS_FILENAME
	string "BT address filename"
	depends on SCSC_CORE
	default "/mnt/vendor/efs/bluetooth/bt_addr"
	help
	  Select the named BT address override file.

config SCSC_BT_USE_HCI_UART
	bool "Enable SCSC BT HCI UART with the bt virtual uart"
	depends on SCSC_BT && BT_HCIUART && BT_HCIUART_SERDEV && SERIAL_CORE
	default n
	help
	  Select to use bt driver as hci uart driver.

config SCSC_BT_KUNIT_TEST
	bool "Enable SCSC BT kunit test"
	depends on KUNIT
	default n
	help
	  Select to unittest on KUnit framework
```

## soc-series/s-android15/drivers/misc/samsung/scsc_bt/kunit/Kconfig
```kconfig
config KUNIT_SCSC_BT_TEST
	tristate "SCSC BT UNIT TEST"
	help
	  Select to unittest on KUnit framework
```

## soc-series/s-android15/drivers/mmc/host/Kconfig
```kconfig
# SPDX-License-Identifier: GPL-2.0-only
#
# MMC/SD host controller drivers
#

comment "MMC/SD/SDIO Host Controller Drivers"

config MMC_DW_SAMSUNG
	tristate "Synopsys DesignWare Memory Card Interface"
	depends on ARC || ARM || ARM64 || MIPS || RISCV || CSKY || COMPILE_TEST
	help
	  This selects support for the Synopsys DesignWare Mobile Storage IP
	  block, this provides host support for SD and MMC interfaces, in both
	  PIO, internal DMA mode and external DMA mode.

config MMC_DW_PLTFM_SAMSUNG
	tristate "Synopsys Designware MCI Support as platform device"
	depends on MMC_DW_SAMSUNG
	default y
	help
	  This selects the common helper functions support for Host Controller
	  Interface based platform driver. Please select this option if the IP
	  is present as a platform device. This is the common interface for the
	  Synopsys Designware IP.

	  If you have a controller with this interface, say Y or M here.

	  If unsure, say Y.

config MMC_DW_EXYNOS_SAMSUNG
	tristate "Exynos specific extensions for Synopsys DW Memory Card Interface"
	depends on MMC_DW_SAMSUNG
	select MMC_DW_PLTFM_SAMSUNG
	help
	  This selects support for Samsung Exynos SoC specific extensions to the
	  Synopsys DesignWare Memory Card Interface driver. Select this option
	  for platforms based on Exynos4 and Exynos5 SoC's.

config MMC_DW_DEBUG
	tristate "Samsung DWMCI debug feature"
	depends on MMC_DW_SAMSUNG
	help
	  This selects support for information logging for debugging.
	  Select this option if this feature is needed on working.

config MMC_DW_EXYNOS_FMP
        bool "EXYNOS Flash Memory Protector for MMC_DW"
	depends on MMC_DW_EXYNOS_SAMSUNG && MMC_CRYPTO
	help
	  This selects the EXYNOS MMC_DW FMP Driver.
	  If you have a controller with this interface, say Y or M here.
	  If unsure, say N.

config MMC_DW_EXYNOS_DUMP_TO_CONSOLE
	tristate "EXYNOS specific dump to console to MMC controller platform driver"
	depends on MMC_DW_DEBUG && (ARCH_EXYNOS || COMPILE_TEST)
	help
	  This selects dumping and printing debuggin information of the EXYNOS
	  specific additions to MMC platform driver.
	  Select this if you have MMC host controller on EXYNOS chipset.
	  If unsure, say N.

config MMC_SRPMB
        tristate "MMC Secure RPMB Support"
	depends on MMC_DW_SAMSUNG
	help
	  This option activates mmc secure rpmb.

config SEC_MMC_FEATURE
	tristate "SEC specific MMC/SD feature"
	depends on MMC_DW_SAMSUNG
	help
	  Enable Samsung MMC/SD feature support.
	  Enabling this allows kernel to use SEC specific feature
	  defined and implemented by SEC.
```

## soc-series/s-android15/drivers/net/wireless/Kconfig
```kconfig
if SOC_S5E9955
source "$(KCONFIG_EXT_SOC_PREFIX)drivers/net/wireless/pcie_scsc/Kconfig"
endif
if SOC_S5E8855
source "$(KCONFIG_EXT_SOC_PREFIX)drivers/net/wireless/scsc/Kconfig"
endif
```

## soc-series/s-android15/drivers/pci/controller/dwc/Kconfig
```kconfig
# SPDX-License-Identifier: GPL-2.0

config PCI_EXYNOS_HOST
	tristate "Samsung Exynos PCIe controller"
	depends on ARCH_EXYNOS || COMPILE_TEST
	select PCIE_DW_HOST
	help
	  Enables support for the PCIe controller in the Samsung Exynos SoCs
	  to work in host mode. The PCI controller is based on the DesignWare
	  hardware and therefore the driver re-uses the DesignWare core
	  functions to implement the driver.

config EXYNOS_PCIE_KUNIT_TEST
	tristate "KUnit tests for pcie" if !KUNIT_ALL_TESTS
	depends on KUNIT
	depends on PCI_EXYNOS_HOST
	default KUNIT_ALL_TESTS

config PCI_EXYNOS_PHYCAL_DEBUG
	tristate "Samsung Exynos PCIe PHY Debug feature"
	depends on ARCH_EXYNOS || COMPILE_TEST
	depends on PCI_EXYNOS_HOST
	select PCIE_DW_HOST

config PCIE_EXYNOS_DWPHY
	tristate "Samsung Exynos PCIe RC with Synopsys PHY"
	depends on PCI_EXYNOS_HOST
```

## soc-series/s-android15/drivers/phy/samsung/Kconfig
```kconfig
# SPDX-License-Identifier: GPL-2.0-only
#
# Phy drivers for Samsung platforms
#
config PHY_SAMSUNG_USB2
	tristate "S5P/Exynos SoC series USB 2.0 PHY driver"
	depends on HAS_IOMEM
	depends on USB_EHCI_EXYNOS || USB_OHCI_EXYNOS || USB_DWC2 || COMPILE_TEST
	select GENERIC_PHY
	select MFD_SYSCON
	default ARCH_EXYNOS
	help
	  Enable this to support the Samsung USB 2.0 PHY driver for Samsung
	  S5Pv210 and Exynos SoCs. This driver provides the interface for USB
	  2.0 PHY. Support for particular PHYs will be enabled based on the SoC
	  type in addition to this driver.

config PHY_EXYNOS4210_USB2
	bool
	depends on PHY_SAMSUNG_USB2
	default CPU_EXYNOS4210

config PHY_EXYNOS4X12_USB2
	bool
	depends on PHY_SAMSUNG_USB2
	default SOC_EXYNOS3250 || SOC_EXYNOS4412

config PHY_EXYNOS5250_USB2
	bool
	depends on PHY_SAMSUNG_USB2
	default SOC_EXYNOS5250 || SOC_EXYNOS5420

config PHY_S5PV210_USB2
	bool "Support for S5PV210"
	depends on PHY_SAMSUNG_USB2
	depends on ARCH_S5PV210 || COMPILE_TEST
	help
	  Enable USB PHY support for S5PV210. This option requires that Samsung
	  USB 2.0 PHY driver is enabled and means that support for this
	  particular SoC is compiled in the driver. In case of S5PV210 two phys
	  are available - device and host.

config PHY_EXYNOS_USBDRD_EUSB
	tristate "Exynos SoC series eUSB DRD PHY driver"
#	depends on ARCH_EXYNOS && OF
#	depends on HAS_IOMEM
	help
	  Enable eUSB DRD PHY support for Exynos SoC series.
	  This driver provides PHY interface for USB 3.0 DRD controller
	  present on Exynos SoC series.

config PHY_EXYNOS_EUSB_REPEATER
	tristate "Exynos SoC series eUSB Repeater driver"
	depends on ARCH_EXYNOS && OF
	depends on HAS_IOMEM
	help
	  Enable eUSB Repeater support for Exynos SoC series.

config PHY_EXYNOS_USBDRD
	tristate "Exynos SoC series USB DRD PHY driver"
	depends on ARCH_EXYNOS && OF
	depends on HAS_IOMEM
	help
	  Enable USB DRD PHY support for Exynos SoC series.
	  This driver provides PHY interface for USB 3.0 DRD controller
	  present on Exynos SoC series.

config PHY_SAMSUNG_USB_CAL
	bool "Samsung USB PHY CAL"
	depends on PHY_EXYNOS_USBDRD || PHY_EXYNOS_USBDRD_EUSB
	help
	  Enable this to support CAL (Chip Abstraction Layer)
	  for Samsung USB PHY controller.

config PHY_SAMSUNG_USB_GEN2
	bool  "Exynos SoC series USB DRD PHY DebugFS"
	depends on PHY_SAMSUNG_USB_CAL
	depends on PHY_EXYNOS_USBDRD || PHY_EXYNOS_USBDRD_EUSB
	help
	  Support SAMSUNG USB3.1 GEN2 PHY.

config PHY_EXYNOS5_USBDRD
	tristate "Exynos5 SoC series USB DRD PHY driver"
	depends on (ARCH_EXYNOS && OF) || COMPILE_TEST
	depends on HAS_IOMEM
	depends on USB_DWC3_EXYNOS
	select GENERIC_PHY
	select MFD_SYSCON
	default y
	help
	  Enable USB DRD PHY support for Exynos 5 SoC series.
	  This driver provides PHY interface for USB 3.0 DRD controller
	  present on Exynos5 SoC series.

config PHY_EXYNOS_MIPI_DSIM
	tristate "Samsung EXYNOS SoC MIPI DSI D-PHY driver"
	depends on HAS_IOMEM
	depends on ARCH_EXYNOS && OF || COMPILE_TEST
	select GENERIC_PHY
	help
	  Support for MIPI DSI DPHY found on Samsung
	  and EXYNOS SoCs.

config EXYNOS_PHYCAL_IF
	tristate "Exynos PHY CAL interface driver"
	help
	  This driver provides PHY interface for Exynos.

config PHY_EXYNOS_MIPI
        tristate "Samsung EXYNOS SoC MIPI CSI/DSI D/C-PHY driver"
        depends on HAS_IOMEM
        depends on ARCH_EXYNOS && OF || COMPILE_TEST
        help
          Support for MIPI CSI and MIPI DSI DPHY found on Samsung
          and EXYNOS SoCs.

config PHY_SUPPORT_SEC_REPEATER_CB
	  tristate "Exynos SoC series is mapping to sec function"
	  help
		Enable Sec Repeater CB to support for SEC function.
		This driver provides OWN sec function to SOC series.
```

## soc-series/s-android15/drivers/pinctrl/Kconfig
```kconfig
# SPDX-License-Identifier: GPL-2.0-only
#
# SAMSUNG PINCTRL infrastructure and pmic drivers
#

config PINCTRL_S2P
	tristate "SAMSUNG PMIC pin controller driver for S.LSI Power Product"
	help
	 This is the pinctrl, pinmux, pinconf and gpiolib common driver for the
	 Samsung GPIO found in the Samsung PMIC's chips, which are using
	 SPMI for communication with SoC.

config PINCTRL_SAMSUNG_S2MPS28
	tristate "SAMSUNG PMIC pin controller driver for s5e9945"
	help
	 This is the pinctrl, pinmux, pinconf and gpiolib driver for the
	 Samsung GPIO found in the Samsung PMIC's chips, which are using
	 SPMI for communication with SoC.

config PINCTRL_SAMSUNG_S2MPM07_9945
	tristate "SAMSUNG PMIC pin controller driver for s5e9945"
	help
	 This is the pinctrl, pinmux, pinconf and gpiolib driver for the
	 Samsung GPIO found in the Samsung PMIC's chips, which are using
	 SPMI for communication with SoC.

config PINCTRL_SAMSUNG_S2MPA05
	tristate "SAMSUNG PMIC pin controller driver for s2mpa05"
	help
	 This is the pinctrl, pinmux, pinconf and gpiolib driver for the
	 Samsung GPIO found in the Samsung PMIC's chips, which are using
	 SPMI for communication with SoC.

config PINCTRL_SAMSUNG_S2SE911
	tristate "SAMSUNG PMIC pin controller driver for s2se911"
	help
	 This is the pinctrl, pinmux, pinconf and gpiolib driver for the
	 Samsung GPIO found in the Samsung PMIC's chips, which are using
	 SPMI for communication with SoC.

config PINCTRL_SAMSUNG_S2MPU15
	tristate "SAMSUNG PMIC pin controller driver for s2mpu15"
	help
	 This is the pinctrl, pinmux, pinconf and gpiolib driver for the
	 Samsung GPIO found in the Samsung PMIC's chips, which are using
	 SPMI for communication with SoC.

config PINCTRL_SAMSUNG_S2MPU16
	tristate "SAMSUNG PMIC pin controller driver for s2mpu16"
	help
	 This is the pinctrl, pinmux, pinconf and gpiolib driver for the
	 Samsung GPIO found in the Samsung PMIC's chips, which are using
	 SPMI for communication with SoC.
```

## soc-series/s-android15/drivers/pinctrl/samsung/Kconfig
```kconfig
# SPDX-License-Identifier: GPL-2.0
#
# Samsung Pin control external drivers
#
config PINCTRL_SAMSUNG_EXT
	tristate "External Pinctrl driver data for Samsung SoCs"
	select GPIOLIB
	select PINMUX
	select PINCONF

config PINCTRL_EXYNOS_EXT
	bool "External Pinctrl common driver part for Samsung Exynos SoCs"
	depends on ARCH_EXYNOS || ARCH_EXYNOS_RISCV || PINCTRL_SAMSUNG_EXT || (COMPILE_TEST && OF)
	select PINCTRL_EXYNOS_EXT_ARM64 if ARCH_EXYNOS && ARM64
	select PINCTRL_EXYNOS_EXT_RISCV if ARCH_EXYNOS_RISCV

config PINCTRL_EXYNOS_EXT_ARM64
	bool "External ARM64 specific pinctrl driver for Samsung Exynos SoCs"
	depends on ARCH_EXYNOS || PINCTRL_SAMSUNG_EXT || (COMPILE_TEST && OF)

config PINCTRL_EXYNOS_EXT_RISCV
	bool "External RISCV specific pinctrl driver for Samsung Exynos SoCs"
	depends on ARCH_EXYNOS_RISCV || PINCTRL_SAMSUNG_EXT || (COMPILE_TEST && OF)

config PINCTRL_SEC_GPIO_DVS
	tristate "Samsung GPIO debugging and verification system"
	depends on SEC_PM && PINCTRL_EXYNOS_ARM64
	default n
```

## soc-series/s-android15/drivers/pwm/Kconfig
```kconfig
# SPDX-License-Identifier: GPL-2.0-only
config PWM_EXYNOS
	tristate "Exynos PWM support"
	depends on PLAT_SAMSUNG || ARCH_EXYNOS || COMPILE_TEST
	depends on HAS_IOMEM
	help
	  Generic PWM framework driver for Samsung Exynos SoCs.
	  Choose Y here only if you build for such Samsung SoC.

	  To compile this driver as a module, choose M here: the module
	  will be called pwm-samsung.
```
