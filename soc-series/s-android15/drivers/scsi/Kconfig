## soc-series/s-android15/drivers/ufs/host/Kconfig
```kconfig
# SPDX-License-Identifier: GPL-2.0+
#
# Kernel configuration file for the UFS host controller drivers.
#
# Copyright (C) 2023 Samsung Electronics Co., Ltd.
#
# Authors:
#	Kiwoong Kim <kwmad.kim@samsung.com>

config SCSI_UFS_SAMSUNG
	tristate "Exynos specific hooks to UFS controller platform driver"
	depends on SCSI_UFSHCD_PLATFORM && (ARCH_EXYNOS || COMPILE_TEST)
	help
	  This selects the Samsung Exynos SoC specific additions to UFSHCD
	  platform driver.  UFS host on Samsung Exynos SoC includes HCI and
	  UNIPRO layer, and associates with UFS-PHY driver.

	  Select this if you have UFS host controller on Samsung Exynos SoC.
	  If unsure, say N.

config EXYNOS_UFS_KUNIT_TEST
	tristate "KUnit tests for samsung UFS" if !KUNIT_ALL_TESTS
	depends on SCSI_UFS_SAMSUNG
	depends on KUNIT
	default KUNIT_ALL_TESTS

config SCSI_UFS_PERF
	tristate "Exynos specific perf hook to UFS controller platform driver"
	depends on SCSI_UFS_SAMSUNG
	help
	  This selects the Samsung Exynos SoC specific performance feature
	  to UFSHCD platform driver.

	  Select this if you have UFS host controller on Samsung Exynos SoC,
	  and want to enable this feature.
	  If unsure, say N.

config SCSI_UFS_DBG
	tristate "Exynos specific dbg hooks to UFS controller platform driver"
	depends on SCSI_UFS_SAMSUNG
	help
	  This selects the Samsung Exynos SoC specific debuggin additions to
	  to UFSHCD platform driver.

	  Select this if you have UFS host controller on Samsung Exynos SoC,
	  and want to enable this feature.
	  If unsure, say N.

config SCSI_UFS_EMUL
	tristate "Exynos specific emul mode to UFS controller platform driver"
	depends on SCSI_UFS_SAMSUNG
	help
	  This selects the Samsung Exynos SoC specific emulation mode
	  to UFSHCD platform driver.

	  Select this if you have UFS host controller on Samsung Exynos SoC,
	  and want to enable this feature.
	  If unsure, say N.

config SCSI_UFS_EXYNOS_SRPMB
	bool "EXYNOS Secure RPMB(Replay Protected Memory Block) UFS Host"
	depends on SCSI_UFS_SAMSUNG
	help
	  RPMB(Replay Protected Memory Block) is a storage which is to store data
	  to the specific memory area in an authenticated and replay protected manner.
	  Usage of nonce and write count register are providing additional
	  protection against replay of messages where messages could be recorded and
	  played back later by an attacker.

	  If you have a controller with this interface, say Y or M here. If unsure, say N.

config SEC_UFS_FEATURE
	tristate "SEC specific UFS feature"
	depends on SCSI_UFSHCD
	help
	  Enable Samsung feature support
	  Enabling this allows kernel to use SEC specific feature
	  defined and implemented by SEC.

config SCSI_UFS_TEST_MODE
	bool "Samsung UFS TEST feature"
	default n
	depends on SEC_UFS_FEATURE
	help
	  This selects support for test mode for debugging.
	  Select this option if this feature is needed on working.

	  If unsure, say N.

config SCSI_UFS_EXYNOS_FMP
        bool "EXYNOS Flash Memory Protector for UFS Host"
        depends on SCSI_UFS_SAMSUNG && SCSI_UFS_CRYPTO
        help
          This selects the EXYNOS UFS FMP Driver.

          Select this if you need a inline crypto engine for your UFS controller.
          If unsure, say N.

choice
        prompt "Option for FMP mode"
        depends on SCSI_UFS_EXYNOS_FMP
        default HW_KEYS_IN_CUSTOM_KEYSLOT

config HW_KEYS_IN_CUSTOM_KEYSLOT
        bool "Init fmp to use hw wrapped keys in custom keyslot"
        depends on SCSI_UFS_EXYNOS_FMP
        help
          Choose here to select that fmp mode to use hw wrapped keys in custom keyslot.

config KEYS_IN_CUSTOM_KEYSLOT
        bool "Init fmp to use keys in custom keyslot"
        depends on SCSI_UFS_EXYNOS_FMP
        help
          Choose here to select that fmp mode to use keys in custom keyslot.

config KEYS_IN_PRDT
        bool "Init fmp to use keys in prdt"
        depends on SCSI_UFS_EXYNOS_FMP
        help
          Choose here to select that fmp mode to use keys in prdt

endchoice
config FMP_EXYNOS_KUNIT_TEST
	tristate "KUnit tests for FMP" if !KUNIT_ALL_TESTS
	depends on KUNIT
	depends on SCSI_UFS_EXYNOS_FMP
	depends on SCSI_UFS_SAMSUNG
	default KUNIT_ALL_TESTS
```

## soc-series/s-android15/drivers/usb/dwc3/Kconfig
```kconfig
# SPDX-License-Identifier: GPL-2.0

config USB_DWC3_EXYNOS_MODULE
	tristate "DesignWare USB3 DRD Core Support"
	depends on (USB || USB_GADGET) && HAS_DMA
	help
	  Say Y or M here if your system has a Dual Role SuperSpeed
	  USB controller based on the DesignWare USB3 IP Core.

	  If you choose to build this driver is a dynamically linked
	  module, the module will be called dwc3.ko.

config EXYNOS_USB_KUNIT_TEST
	tristate "KUnit tests for DWC3" if !KUNIT_ALL_TESTS
	depends on KUNIT
	depends on USB_DWC3_EXYNOS_MODULE
	default KUNIT_ALL_TESTS

config USB_DWC3_EXYNOS
	tristate "Samsung Exynos SoC Platform"
	depends on (ARCH_EXYNOS || COMPILE_TEST) && OF
	default USB_DWC3
	help
	  Recent Samsung Exynos SoCs (Exynos5250, Exynos5410, Exynos542x,
	  Exynos5800, Exynos5433, Exynos7) ship with one DesignWare Core USB3
	  IP inside, say 'Y' or 'M' if you have one such device.

config USB_EXYNOS_TPMON_MODULE
	tristate "Samsung Exynos USB TPMON"
	depends on USB_DWC3_EXYNOS
	help
	  Enable/Disable Exynos USB TPMON
	  Say 'Y' or 'M' here if you have one such device

config EXYNOS_USBDRD_PHY30
	bool "Samsung Exynos USB3.0 PHY"
	default n
	help
	  Select this if you have Samsung Exynos USB3.0 PHY
	  device.

config USB_DEBUG_MODULE
	tristate "Samsung Exynos USB debug Module"
	default n
	help
	  Enable/Disable Exynos USB debug log
	  Say 'Y' or 'M' here if you have one such device

config SEC_USB_CB
	tristate "Exynos SoC series is mapping to sec usb function"
	help
	 Enable Sec USB CB to support for SEC function.
	 This driver provides OWN sec function to SOC series.
	 If you choose to build this driver is a dynamically linked
	 module, the module will be called sec_usb_cb.ko.
```

## soc-series/s-android15/drivers/usb/gadget/Kconfig
```kconfig
# SPDX-License-Identifier: GPL-2.0

config USB_CONFIGFS_RNDIS_MP
	tristate "RNDIS_MP"
	depends on USB_CONFIGFS
	depends on NET
	help
	   Samsung RNDIS MP(Multi Packet) supports RNDIS
	   functionality with offloading RNDIS data transfers.

config USB_F_RNDIS_MP
	tristate "F_RNDIS_MP"
	depends on USB_CONFIGFS
	depends on NET
	help
	   Samsung RNDIS F MP(Multi Packet) supports RNDIS
           functionality with offloading RNDIS data transfers.
```

## soc-series/s-android15/drivers/vision/Kconfig
```kconfig
config VISION_SUPPORT
	tristate "Vision Support"
	help
	  If you want to use hardware acceleration for vision
	  enable this option and other options below.

if VISION_SUPPORT

if SOC_S5E9955
source "$(KCONFIG_EXT_SOC_PREFIX)drivers/vision/npu/Kconfig"
source "$(KCONFIG_EXT_SOC_PREFIX)drivers/vision/npu/interface/Kconfig"
endif

if SOC_S5E8855
source "$(KCONFIG_EXT_SOC_PREFIX)drivers/vision/npu/Kconfig"
source "$(KCONFIG_EXT_SOC_PREFIX)drivers/vision/npu/interface/Kconfig"
endif

if SOC_S5E9945
source "$(KCONFIG_EXT_SOC_PREFIX)drivers/vision/npu9945/Kconfig"
source "$(KCONFIG_EXT_SOC_PREFIX)drivers/vision/npu9945/interface/Kconfig"
endif

endif # VISION_SUPPORT
```

## soc-series/s-android15/drivers/vision/npu/Kconfig
```kconfig
menuconfig EXYNOS_NPU
	tristate "Exynos NPU driver (Test)"
	depends on VISION_SUPPORT
	help
		Exynos NPU Test device driver

config NPU_DEBUG_MEMDUMP
	bool "Enable memory dump for memories defined in device tree by name"
	default n
	help
	This is a debug option to enable dumping arbitrary NPU memory
	which is defined by name in the device tree.
	It can be ION allocated memory or physical IO memory.
	Memory can be dumped with a simple debugfs interface:
	Write memory name, read memory data (must use the same RW file descriptor).
	Example: 'exec 3<>/d/npu/memdump && echo -n fwmem >&3 && cat <&3 > fwmem.bin; 3>&-'

config NPU_STM
	bool "use STM for debugging"
	depends on CORESIGHT_STM
	default y
	help
		This feature need to analyze npu complier.

config NPU_USE_ASYNC
	bool "use async"
	default n
	help
		This feature enables async execution in device driver.

config NPU_STM_NEED_BUSP_DIV
	bool "Need BUSP div on STM mode"
	depends on NPU_STM
	default n
	help
		If need to busp div ratio, this feature should be enable

config NPU_FW_ACCESS_MCT
	bool "FW Use MCT"
	depends on NPU_STM
	default n
	help
		If fw use MCT, this feature should be enable

if EXYNOS_NPU

config NPU_ZEBU_EMULATION
	bool
	default n

config NPU_AFM
	bool "use AFM feature"
	default n
	help
		This feature support hw thrott.

config NPU_USE_MAILBOX_GROUP
	bool "use group in mailbox"
	default y
	help
		This feature can support mailbox group in mailbox.

config NPU_USE_HW_DEVICE
	bool "use hw-device platform driver"
	default n
	help
		This feature can support additional function to control HW device module
		which is defined as individual module inside of NPU/DSP IP.
		This module can represent individual control of CPU, MIF or INT to support
		NPU-related controls.

config DSP_USE_VS4L
	bool "support DSP functionality with VS4L"
	default n
	help
		This feature can support DSP functionality with VS4L.
		This feature includes DL (Dynamic Loading).

config NPU_USE_S2MPU_NAME_IS_NPUS
	bool "name of NPU S2MPU is NPUS"
	default n
	help
		This feature can support name of NPU S2MPU is NPUS. Default name is DNC.

config NPU_USE_LLC
	bool "LLC"
	default n
	help
		TODO

config NPU_USE_IMB_ALLOCATOR
	bool "use CHUNK-IMB allocator"
	default n
	help
		use CHUNK-IMB allocator

		CHUNK-IMB allocator for memory management of intermediate buffer.
		Host used to allocate the memory for an intermediate buffer in the past,
		but the owner of intermediate buffer allocation should be changed to NPU firmware because
		the several requests with unbounded property, which are issued from the same network,
		should be able to be processed on all NPU cores in terms of hardware utilization.
		Therefore NPU firmware should be able to allocate a different intermediate buffer on runtime,
		and host does not have to allocate memory for intermediate buffer more.

config NPU_NCP_VERSION
	int "NPU NCP Version"
	range 26 28
	default 28
	help
		NPU NCP Version

config NPU_NUM_CORES
	int "NPU NUM Cores"
	range 1 4
	default 2
	help
		NPU NUM Cores

config NPU_USE_UTIL_STATS
	bool "NPU UTIL STATS"
	default n
	help
		Use utilization of HW for exynos stats

config NPU_USE_ESCA_DTM
	bool "use ESCA_DTM"
	default n
	help
		use ESCA_DTM for NPU thermal

config NPU_USE_DTM_EMODE
	bool "use DTM_EMODE"
	default n
	help
		use DTM_EMODE for NPU thermal

config NPU_USE_PI_DTM
	bool "use PI_DTM"
	default n
	help
		use PI_DTM for NPU thermal

config NPU_USE_PI_DTM_DEBUG
	bool "use PI_DTM_DEBUG"
	default n
	help
		use PI_DTM_DEBUG for NPU thermal

config NPU_SET_DNC_FREQ
	bool "set DNC_FREQ"
	default n
	help
		set DNC_FREQ for preset

config NPU_GOVERNOR
	bool "NPU Governor"
	default n
	help
		use governor

config NPU_BRINGUP_NOTDONE
	bool "during NPU bringup"
	default n
	help
		This option can be used during any SOC bringup.

config NPU_IMB_ASYNC_ALLOC
    bool "IMB async alloc"
	default n
	    help
		    Alloc IMB asynchronous

config NPU_CLOCK
	bool "USE specific clock source"
	default n
	help
		device driver use specifi clock source form dtsi

config NPU_ONE_BUCK
	bool "All GNPU0/1 SNPU0/1 are in one buck"
	default y
	help
		device driver parse PMIC buck info from dtsi

		Delete this config after PMIC update in mainline

config NPU_PM_SLEEP_WAKEUP
	bool "NPU can enter ap sleep when no job"
	default n
	help
		NPU can enter ap sleep when no job

config NPU_WITH_CAM_NOTIFICATION
	bool "received camera's noti"
	default n
	help
		For Quadra, Root HW

menuconfig NPU_UNITTEST
	bool "Build unittest for Vision"
	depends on VISION_SUPPORT
	help
	  Include unittest code into the vision-core
endif
```

## soc-series/s-android15/drivers/vision/npu/interface/Kconfig
```kconfig
config NPU_INTERFACE
	bool "Select Interface"
	help
	  This is NPU interface

config NPU_HARDWARE
	bool "Use Hardware"
	depends on NPU_INTERFACE
	help
 	  This is hardware device

config NPU_MAILBOX_VERSION
	int "NPU Mailbox Version"
	range 9 10
	default 10
	help
	  NPU Mailbox Version

config NPU_COMMAND_VERSION
	int "NPU Command Version"
	range 12 13
	default 13
	help
	  NPU Command Version
```

## soc-series/s-android15/drivers/watchdog/Kconfig
```kconfig
# SPDX-License-Identifier: GPL-2.0-only

#
# Watchdog device configuration
#

config S3C2410_WATCHDOG_EXT
	tristate "S3C2410 Watchdog driver for External module"
	depends on ARCH_S3C24XX || ARCH_S3C64XX || ARCH_S5PV210 || \
		   ARCH_EXYNOS || ARCH_EXYNOS_RISCV || \
		   COMPILE_TEST
	select WATCHDOG_CORE
	select MFD_SYSCON if ARCH_EXYNOS
	help
	  This external driver were copied from original linux mainline.
	  We are modifying this driver as module, but mainline cannot accept
	  recent driver changes. So, detatch from mainline and modify here.

	  Watchdog timer block in the Samsung SoCs. This will reboot
	  the system when the timer expires with the watchdog enabled.

	  The driver is limited by the speed of the system's PCLK
	  signal, so with reasonably fast systems (PCLK around 50-66MHz)
	  then watchdog intervals of over approximately 20seconds are
	  unavailable.

	  The driver can be built as a module by choosing M, and will
	  be called s3c2410_wdt

config WATCHDOG_EXYNOS_KUNIT_TEST
	tristate "KUnit tests for watchdog driver" if !KUNIT_ALL_TESTS
	depends on KUNIT
	depends on S3C2410_WATCHDOG_EXT
	default KUNIT_ALL_TESTS

config S3C2410_EXT_SHUTDOWN_REBOOT
	bool "Support watchdog reset after watchdog shutdown"
	depends on S3C2410_WATCHDOG_EXT
	default n
	help
	  This config disable the shutdown function of S3C2410 watchdog.
	  To prevent stuck after watchdog driver shutdown, shutdown
	  function will not stop or disable watchdog and it will just
	  kick 30 second. It will prevent being stucked in reset
	  sequence with some other failure.
	  This feature is not recommeneded for debugging.

config S3C2410_EXT_BUILTIN_WATCHDOG
	bool "Support S3C2410 Built-in Watchdog API"
	depends on S3C2410_WATCHDOG_EXT
	default n
	help
	  Supports direct WDT reset API for builtin call only.
	  S3C2410_WATCHDOG driver support normal watchdog feature including
	  direct watchdog reset API. But when it works as kernel module,
	  builtin APIs cannot use it.
	  So, support direct WDT reset API only for SOC debug purpose.

config S3C2410_EXT_WTCNT_MAXCNT
	hex "S3C2410 Maximum WTCNT"
	depends on S3C2410_WATCHDOG_EXT
	default 0xffff
	help
	  This config will set Maximum WDT count value.
	  If you don't set, default value is 0xffff.
```
