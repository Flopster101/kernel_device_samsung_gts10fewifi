## soc-series/s-android15/drivers/soc/samsung/exynos/debug/Kconfig
```kconfig
menuconfig EXYNOS_DEBUG
        bool "Exynos Debug Features"
        depends on ARCH_EXYNOS
        default n

if EXYNOS_DEBUG
menuconfig DEBUG_SNAPSHOT
	tristate "Debug SnapShot Support"
	depends on EXYNOS_DEBUG
	default n
	help
	  Debug snapshot supports SoC debugging easily. This feature supports
	  to trace kernel events and other module events such frequceny change
	  and IPC. This supports to save GPR and PC when panic or exception and
	  to enter ramdump mode when panic is occurred and other exception.
	  This supports to reserve memory for h/w debug feature such as
	  scan2dram, arraydump.

config DEBUG_SNAPSHOT_API
	bool "Support Debug Snapshot API"
	depends on DEBUG_SNAPSHOT
	default n
	help
	  Debug Snapshot API supports access of dss log and dss log item.
	  If you use this API, you can get last or first index, paddr of item.

config DEBUG_SNAPSHOT_FREQ_DOMAIN_NUM
	int "Number of freq logging domain type"
	range 4 32
	default 32
	help
	  This option decides number of frequency logging domain type.

config DEBUG_SNAPSHOT_LOG_ITEM_SIZE
	int "Number of logging item base size"
	range 256 1024
	default 1024
	help
	  This option decides size of logging item.

config DEBUG_SNAPSHOT_NR_CPUS
	int "NR CPUS for kevent"
	range 1 16
	default 8
	depends on DEBUG_SNAPSHOT
	help
	  This sets the number of cores for the kevents logging data structure declaration.

config DEBUG_SNAPSHOT_SFRDUMP
	tristate "Debug Snapshot SFRDUMP"
	depends on DEBUG_SNAPSHOT
	default n
	help
	  This supports sfrdump to string format into the DRAM
	  if kernel panic happened. If you want to get dump,
	  you should write list of sfr registers in device tree.
	  If you want to dump sfr register, you say Y here.

config DEBUG_SNAPSHOT_QUICKDUMP
	tristate "Debug Snapshot quickdump"
	depends on DEBUG_SNAPSHOT
	default n
	help
	  This is for weight ligntening of ramdump. If DRAM size is too big,
	  Ramdump is also big. Then it takes a long time to get ramdump.
	  So we get important data such as dss logging and H/W raw data.
	  If you access text symbol and stack data, you could get them.

config DEBUG_SNAPSHOT_DEBUG_KINFO
	tristate "Debug Kernel Information Support"
	depends on DEBUG_SNAPSHOT
        default n
	help
	  This prepares memory for the debug-kinfo driver

config DEBUG_SNAPSHOT_EXYNOS_KUNIT_TEST
	tristate "KUnit tests for debug_snapshot driver" if !KUNIT_ALL_TESTS
	depends on KUNIT
	depends on DEBUG_SNAPSHOT
	default KUNIT_ALL_TESTS

config EXYNOS_DEBUG_TEST
        tristate "Exynos debug feature test"
        depends on DEBUG_SNAPSHOT
        default n
	help
	  This can be tested for various errors. If you say y you can confirm
	  that the debug feature works properly for the error.

config EXYNOS_ITMON
        tristate "Exynos IPs Traffic Monitor"
        depends on EXYNOS_DEBUG
        default n

config EXYNOS_ITMON_V2
        tristate "Exynos IPs Traffic Monitor V2"
        depends on EXYNOS_DEBUG
        default n

config ITMON_EXYNOS_KUNIT_TEST
	tristate "KUnit tests for itmon driver" if !KUNIT_ALL_TESTS
	depends on KUNIT
	depends on EXYNOS_ITMON_V2
	default KUNIT_ALL_TESTS

config EXYNOS_CORESIGHT
        tristate "Enable Coresight of exynos"
	depends on DEBUG_SNAPSHOT
        default n
	help
	  This is support to show PC values of each cpus when kernel panic
	  caused by hard lockup.

config EXYNOS_ECC_HANDLER
	tristate "Exynos support ECC handler"
	depends on DEBUG_SNAPSHOT
	default n
	help
	  If ECC happened in cache of CPU, interrupt occurs to cpu.

config EXYNOS_LINKECC_HANDLER
	tristate "Exynos support LINKECC handler"
	depends on DEBUG_SNAPSHOT
	default n
	help
	  If LINKECC happens at DRAM link, interrupt occurs.

config EXYNOS_DDRPHYLOCKDELTA_HANDLER
	tristate "Exynos support DDRPHYLOCK handler"
	depends on DEBUG_SNAPSHOT
	default n
	help
	  If DDRPHY LOCKVALUE overs at DDRPHY, interrupt occurs.	  

config EXYNOS_HARDLOCKUP_WATCHDOG
	tristate "Exynos Hardlockup Watchdog"
	depends on DEBUG_SNAPSHOT
	default n

config EXYNOS_ADV_TRACER
        tristate "Exynos Advanced Tracer"
        depends on ARM || ARM64
        default n
	help
	  This driver communicates with debugcore via mailbox. This supports
	  ipc API with debugcore. If you make a driver to communicates with
	  debugcore, you should use this API.

config EXYNOS_ADV_TRACER_S2D
        tristate "Exynos Advanced Tracer: Plug-in - S2D"
        depends on EXYNOS_ADV_TRACER
        default n
	help
	  This driver communicates with scan2dram plugin in debugcore.

config EXYNOS_EHLD
        tristate "Exynos support Early Hardlockup Detector"
        depends on EXYNOS_DEBUG
        default n

config EXYNOS_SSLD
        tristate "Exynos support S2R Scenario Lockup Detector"
        depends on EXYNOS_DEBUG
        default n

config EXYNOS_GETCPUSTATE
        tristate "Exynos interface to get the cpu power state"
        depends on EXYNOS_DEBUG
        default n

config EXYNOS_PED
        tristate "Exynos Parity Error Detector"
        depends on EXYNOS_DEBUG
        depends on SOC_S5E9945
        default n
        help
          This driver detects LH parity errors, and supports only S5E9945 EVT1.

config EXYNOS_PED_V2
	tristate "Exynos Parity Error Detector V2"
	depends on EXYNOS_DEBUG
	default n
	help
	  This driver detects parity errors of LH and TREX.

config EXYNOS_CORESIGHT_ETM
		tristate "Enable ETM driver"
		depends on ARM || ARM64
		default n

config EXYNOS_CORESIGHT_ETF
		tristate "Enable ETF (FIFO or Buffer)"
		depends on EXYNOS_CORESIGHT_ETM
		default n

config EXYNOS_CORESIGHT_ETR
		tristate "Enable ETR (Route DRAM)"
		depends on EXYNOS_CORESIGHT_ETF
		default n

endif
```

## soc-series/s-android15/drivers/soc/samsung/exynos/esca/Kconfig
```kconfig
#
# ESCA driver configuration
#

menuconfig EXYNOS_ESCA
	tristate "ESCA driver support"
	depends on ARCH_EXYNOS
	default n
	help
	  Enable ESCA support

if EXYNOS_ESCA

config EXYNOS_MFD_SPMI
	bool "EXYNOS_MFD_SPMI support"
	depends on EXYNOS_ESCA
	default n
	help
	  Enable MFD_SPMI support

config EXYNOS_ESCA_S2D
	tristate "EXYNOS_ESCA_S2D support"
	help
	  Enable ESCA_S2D support

config EXYNOS_ESCA_PLGDBG
	tristate "EXYNOS ESCA plugin debugfs support"
	help
	  Enable PLUGIN_DBG support

config ESCA_FLEXPMU_DBG
        tristate "Exynos FLEXPMU debugging interface"
	depends on SOC_S5E9955 || SOC_S5E8855
	help
	Support FLEXPMU for Exynos SoC.

config ESCA_SLEEP_PROFILER
	bool "EXYNOS ESCA sleep latency calculation support"
	default n
	help
		Enable ESCA_SLEEP_PROFILER

endif
```

## soc-series/s-android15/drivers/soc/samsung/exynos/exynos-el2/Kconfig
```kconfig
# SPDX-License-Identifier: GPL-2.0-only
#
# Exynos EL2 solutions
#

config EXYNOS_EL2
	tristate "Exynos EL2 Solution"
	depends on ARCH_EXYNOS
	help
	  Exynos EL2 Solution has implemented Stage 2
	  MMU and IOMMU.

config EXYNOS_S2MPU
        tristate "Exynos Stage 2 Memory Protection Unit(S2MPU)"
	depends on EXYNOS_EL2
        help
          Exynos S2MPU driver to set S2MPU access permission.

config EXYNOS_S2MPU_PD
	bool "Exynos S2MPU PM domain support"
	depends on EXYNOS_S2MPU
	default n
	help
	  Backup and restore S2MPU when PM domains
	  turn on and off.
```

## soc-series/s-android15/drivers/soc/samsung/exynos/exynos-pkvm-module/Kconfig
```kconfig
# SPDX-License-Identifier: GPL-2.0-only
#
# Exynos pKVM module
#

config EXYNOS_PKVM_MODULE
	tristate "Exynos Protected KVM(pKVM) module"
	depends on ARCH_EXYNOS
	help
	  Exynos pKVM module for vendor-specific operation on core pKVM.

config EXYNOS_PKVM_S2MPU
	tristate "Exynos S2MPU Module for pKVM"
	depends on (EXYNOS_S2MPU && EXYNOS_PKVM_MODULE)
	help
	  Exynos S2MPU module driver for protected KVM.
```

## soc-series/s-android15/drivers/soc/samsung/exynos/gnssif/Kconfig
```kconfig
config EXYNOS_GNSS_IF
	tristate "Exynos GNSS interface driver"
	default n
	help
	  Exynos GNSS interface driver

config EXYNOS_GNSS_IF_KUNIT_TEST
	tristate "KUnit tests for GNSS interface" if !KUNIT_ALL_TESTS
	depends on KUNIT
	default KUNIT_ALL_TESTS
```

## soc-series/s-android15/drivers/soc/samsung/exynos/profiler/Kconfig
```kconfig
config EXYNOS_PROFILER_MAIN
	tristate "Exynos Multi IP Governor support"
	default n
	help
	  Support Multi IP Governor for Exynos SoC.

config EXYNOS_PROFILER_CPU
	tristate "Exynos CPU Profiler support"
	depends on EXYNOS_PROFILER_MAIN
	default n
	help
	  Support CPU Profiler for Exynos SoC.

config EXYNOS_PROFILER_MIF
	tristate "Exynos MIF Profiler support"
	depends on EXYNOS_PROFILER_MAIN
	default n
	help
	  Support MIF Profiler for Exynos SoC.

config EXYNOS_PROFILER_GPU
	tristate "Exynos GPU Profiler support"
	depends on EXYNOS_PROFILER_MAIN
	default n
	help
	  Support GPU Profiler for Exynos SoC.

config EXYNOS_PROFILER_DSU
	tristate "Exynos DSU Profiler support"
	depends on EXYNOS_PROFILER_MAIN
	default n
	help
	  Support DSU Profiler for Exynos SoC.

config EXYNOS_PROFILER_GFLOW
	tristate "Exynos Profiler GFLOW feature"
	depends on EXYNOS_PROFILER_MAIN
	default n
	help
	  Exynos Profiler GFLOW feature
```

## soc-series/s-android15/drivers/soc/samsung/exynos/psp/Kconfig
```kconfig
#
# Exynos Primary Security Processor configuration
#

config EXYNOS_PSP
	tristate "Exynos Primary Security Processor"
	depends on ARCH_EXYNOS
	help
	  Support Primary Security Processor
```

## soc-series/s-android15/drivers/soc/samsung/hts/Kconfig
```kconfig
#
# Hedgin Tactics System
#

menuconfig HTS
	tristate "HTS driver support"
	depends on ARCH_EXYNOS
	default n
	help
	 Enable HTS driver support

if HTS

config HTS_EXT
	bool "HTS Links with External Devices"
	default n
	help
	 Enable HTS Links with External Devices

endif
```

## soc-series/s-android15/drivers/soc/samsung/hwdecomp/Kconfig
```kconfig
#  SPDX-License-Identifier: GPL-2.0

config VENDOR_ZRAM_LZO_HW_DECOMP
	tristate "Exynos HW Decompression engin driver"
	depends on CRYPTO_LZO
	default n

config VENDOR_ZRAM_LZO_HW_DECOMP_KUNIT_TEST
	tristate "KUnit tests for Exynos HW Decompression engin driver" if !KUNIT_ALL_TESTS
	depends on KUNIT
	depends on VENDOR_ZRAM_LZO_HW_DECOMP
	default KUNIT_ALL_TESTS
```

## soc-series/s-android15/drivers/spi/Kconfig
```kconfig
# SPDX-License-Identifier: GPL-2.0-only
#
# External SPI driver configuration
#
comment "SPI Drivers"

config SPI_S3C64XX_EXT
	tristate "Samsung S3C64XX/Exynos SoC series type SPI"
	depends on (PLAT_SAMSUNG || ARCH_EXYNOS || COMPILE_TEST)
	help
	  SPI driver for Samsung S3C64XX, Exynos SoCs.
	  Choose Y/M here only if you build for such Samsung SoC.

config SPI_S3C64XX_EXT_KUNIT_TEST
	tristate "Kunit test for Samsung S3C64XX/Exynos SoC series type SPI" if !KUNIT_ALL_TESTS
	depends on KUNIT
	depends on SPI_S3C64XX_EXT
	default KUNIT_ALL_TESTS
```

## soc-series/s-android15/drivers/tsmux/Kconfig
```kconfig
#
# Exynos tsmux device driver
#

config VIDEO_EXYNOS_TSMUX
	tristate "EXYNOS TSMUX Driver"
	default n
	help
	  Tsmux driver for WFD

config TSMUX_EXYNOS_KUNIT_TEST
	tristate "KUnit tests for TSMUX" if !KUNIT_ALL_TESTS
	depends on KUNIT
	depends on VIDEO_EXYNOS_TSMUX
	default KUNIT_ALL_TESTS
```

## soc-series/s-android15/drivers/tty/serial/Kconfig
```kconfig
# SPDX-License-Identifier: GPL-2.0
#
# Serial device configuration
#

config SERIAL_EXYNOS
	tristate "Exynos SoC serial support"
	depends on SERIAL_SAMSUNG
	select SERIAL_CORE
	help
	  Support for the on-chip UARTs on the Samsung Exynos SOC.
	  It provie /dev/ttySAC0,1,2 for tty uart console.
	  Exynos chip cannot use mainline samsung_tty driver, so modify
	  some of it and use it as module driver.

config SERIAL_EXYNOS_KUNIT_TEST
	tristate "Exynos SoC serial Kunit Test" if !KUNIT_ALL_TESTS
	depends on KUNIT
	depends on SERIAL_EXYNOS
	default KUNIT_ALL_TESTS

config S3C_LOWLEVEL_UART_PORT
        int "S3C UART to use for low-level messages"
        default 0
        help
          Choice of which UART port to use for the low-level messages,
          such as the `Uncompressing...` at start time. The value of
          this configuration should be between zero and two. The port
          must have been initialised by the boot-loader before use.

config SERIAL_SAMSUNG_HWACG
        bool "HWACG(HW Auto Clock Gating) support for Samsung UART port"
        default y
        help
          If HWACG is enabled on UART, System power mode will goes into
          suspend state only when UART UCON Tx, Rx bit was disabled.
          To support HWACG on UART, this configuration should be selected.

config SERIAL_EXYNOS_UARTS
	int
	depends on SERIAL_EXYNOS
	default 16
	help
	  Select the number of available UART ports for the Samsung
	  Exynos serial driver
```
