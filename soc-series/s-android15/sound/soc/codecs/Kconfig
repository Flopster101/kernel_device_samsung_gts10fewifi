## soc-series/s-android15/sound/soc/codecs/Kconfig
```kconfig
# SPDX-License-Identifier: GPL-2.0-only
# Helper to resolve issues with configs that have SPI enabled but I2C
# modular, meaning we can't build the codec driver in with I2C support.
# We use an ordered list of conditional defaults to pick the appropriate
# setting - SPI can't be modular so that case doesn't need to be covered.
config SND_SOC_I2C_AND_SPI
	tristate
	default m if I2C=m
	default y if I2C=y
	default y if SPI_MASTER=y

menu "CODEC drivers"

config SND_SOC_ALL_CODECS
	tristate "Build all ASoC CODEC drivers"
	depends on COMPILE_TEST
	imply SND_SOC_CS42L56
	imply SND_SOC_CS42L73
	imply SND_SOC_CS4234
	imply SND_SOC_CS4265
	imply SND_SOC_CS4270
	imply SND_SOC_CS4271_I2C
	imply SND_SOC_CS4271_SPI
	imply SND_SOC_CS42XX8_I2C
	help
	  Normally ASoC codec drivers are only built if a machine driver which
	  uses them is also built since they are only usable with a machine
	  driver.  Selecting this option will allow these drivers to be built
	  without an explicit machine driver for test and development purposes.


	  Support for the bus types used to access the codecs to be built must
	  be selected separately.

	  If unsure select "N".

config SND_SOC_ABOX_WM_ADSP
	tristate
	select FW_CS_DSP
	select SND_SOC_COMPRESS
	default y if SND_SOC_CS35L43=y
	default m if SND_SOC_CS35L43=m

config SND_SOC_CS35L43
	tristate "Cirrus Logic CS35L43 CODEC"

config SND_SOC_CS35L43_I2C
	tristate "Cirrus Logic CS35L43 CODEC (I2C)"
	depends on I2C
	select REGMAP_I2C
	select SND_SOC_CS35L43

config SND_SOC_CS35L43_SPI
	tristate "Cirrus Logic CS35L43 CODEC (SPI)"
	depends on SPI_MASTER
	select REGMAP_SPI
	select SND_SOC_CS35L43
endmenu
```

## soc-series/s-android15/sound/soc/samsung/exynos/codecs/Kconfig
```kconfig
# SPDX-License-Identifier: GPL-2.0-only
config SND_SOC_SAMSUNG_S5M3500X
	tristate "S5M3500X CODEC"
	help
	  Say Y if you want to use S5M3500X Audio Codec.
```

## soc-series/s-android15/sound/usb/Kconfig
```kconfig
# SPDX-License-Identifier: GPL-2.0-only
# ALSA USB drivers

if SND_USB && USB

config SND_EXYNOS_USB_AUDIO
	bool "EXYNOS USB Audio offloading"
	depends on SND_USB_AUDIO && SND_SOC_SAMSUNG_ABOX
	help
	 Say Y here to include support for Exynos USB Audio ABOX offloading.

config SND_EXYNOS_USB_AUDIO_GIC
	bool "EXYNOS USB Audio offloading gic"
	depends on SND_USB_AUDIO
	help
	 Say Y here to include support for Exynos USB Audio ABOX offloading.

config SND_EXYNOS_USB_AUDIO_MODULE
	tristate "EXYNOS USB Audio offloading module"
	depends on SND_USB_AUDIO && SND_SOC_SAMSUNG_ABOX
	help
	 Say Y here to include support for Exynos USB Audio ABOX offloading.

endif	# SND_USB
```
