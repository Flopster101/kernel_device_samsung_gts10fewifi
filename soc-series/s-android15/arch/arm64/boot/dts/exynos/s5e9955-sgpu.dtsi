/*
 * SAMSUNG SGPU device tree source
 *
 * Copyright (c) 2023 Samsung Electronics Co., Ltd.
 *		http://www.samsung.com
 *
 * This program is free software; you can redistribute it and/or modify
 * it under the terms of the GNU General Public License version 2 as
 * published by the Free Software Foundation.
 */

#define IFPO_DISABLED	0x0
#define IFPO_ABORT	0x1
#define IFPO_HALF_AUTO	0x2

/ {
	/* sgpu */
	sgpu: sgpu@22200000 {
		#address-cells = <0x2>;
		#size-cells = <0x1>;
		#cooling-cells = <2>; /* min followed by max */
		compatible = "samsung-sgpu,samsung-sgpu";
		reg = <
			0x0 0x22200000 0x100000
			0x0 0x22300000 0x100000
			0x0 0x220F0000 0x5000
			0x0 0x220D0000 0x1000
			0x0 0x22000000 0x2000
			0x0 0x22040000 0x10000
			>;
		reg-names = "gpu", "doorbell", "debug", "pwrctl", "sysreg", "htu";
		interrupts = <GIC_SPI INTREQ__GPU_INT IRQ_TYPE_LEVEL_HIGH>,
			     <GIC_SPI INTREQ__HTU_G3D_INT IRQ_TYPE_LEVEL_HIGH>;
		interrupt-names =  "SGPU", "GPU-AFM";

		chip_revision = <0x03600100>;
		genID = <0x1>;
		gl2acem_instances_count = <0x4>;
		samsung,imgloader-s2mpu-support;
		dma-coherent;
		power-domains = <&pd_g3dcore>;

		g3d_cmu_cal_id = <ACPM_DVFS_G3D>;
		gpu_power_coeff = <625>;
		ect-coeff-index = <4>;
		dm_type = <DM_G3D>;

		/* GPU DVFS */
		freq_table = <240000 298000 356000 404000 452000 509000
			      557000 596000 653000 711000 768000 816000 903000 999000>;
		min_freq = <240000>;
		max_freq = <999000>;
		min_threshold = "0 298000:60 404000:65 903000:78";
		max_threshold = "75 298000:80 509000:85 903000:95";
		downstay_time = "8 452000:32";
		mif_min_lock = "676000 452000:2028000 596000:2730000 711000:3172000 903000:4205000";
		mif_cl_boost_min_lock = "421000 452000:1014000 509000:1352000 711000:1539000 768000:1716000 816000:4780000";
		cl_boost_freq = <999000>;
		cl_boost_dsu_freq = <1728000>;
		mo_scenario = "default 452000:g3d_performance";
		llc_ways = "0 509000:12";
		highspeed_freq = <452000>;
		highspeed_load = <99>;
		highspeed_delay = <0>;

		/* GPU VF */
		gvf_table = <120000>;
		gvf_run_freq = <240000>;

		/* DIDT */
		didt_threshold = <120000>;
		edc_threshold = <999000>;
		didt = <0x0 0x2200ff00 0x1 0x82000000 0x2 0x202000a6 0x4 0x000c3041 0x8 0x01010001
			0x9 0x11110421 0xa 0x25291249 0xb 0x00002aaa 0xd 0x00010023 0xe 0x00000401
			0x10 0x962a4108 0x11 0x000000ff 0x14 0x00401c40 0x15 0x0000004b
			0x16 0x01010001 0x17 0x11110421 0x18 0x25291249 0x19 0x00002aaa>;

		/* GPU AFM */
		interrupt-src = <2>; /* MAIN_PMIC=1, SUB_PMIC=2, EXTRA_PMIC=3 */
		pmic-num = <3>;
		s2mps-afm-enable-offset = <0x18>; /* AFM enable */
		s2mps-afm-level-offset = <0x19>; /* AFM level */
		down-step = <1>;
		release-duration = <15>;
		register-duration = <15000>; /* GPU init faster than loading PMIC interface */

		/* IFPO */
		ifpo_type = <IFPO_HALF_AUTO>;
		ifpo_cal_id = <0xB1380026>;

		/* GPU INFO */
		gc-max-shader-engines = <2>;		/* GPU__GC__NUM_SE */
		gc-max-cu-per-sh = <4>;			/* GPU__GC__NUM_SA_PER_SE * GPU__GC__NUM_WGP_PER_SA */
		gc-max-sh-per-se = <2>;			/* GPU__GC__NUM_SA_PER_SE */
		gc-max-backends-per-se = <4>;		/* GPU__GC__NUM_RB_PER_SE */
		gc-max-texture-channel-caches = <4>;	/* GPU__GC__NUM_GL2C */
		gc-max-gprs = <1024>;			/* GPU__GC__NUM_GPRS */
		gc-max-gs-threads = <32>;		/* GPU__GC__NUM_MAX_GS_THDS */
		gc-vgt-table-depth = <32>;		/* GPU__GC__GS_TABLE_DEPTH */
		gc-prim-buffer-depth = <1792>;		/* GPU__GC__GSPRIM_BUFF_DEPTH */
		gc-double-offchip-lds-buffer = <1>;	/* GPU__GC__DOUBLE_OFFCHIP_LDS_BUFFER */
		gc-wave-front-size = <32>;		/* GC__SQ_WAVE_SIZE */
		gc-max-waves-per-simd = <16>;		/* GPU__GC__NUM_WAVES_PER_SIMD */
		gc-max-scratch-slots-per-cu = <32>;	/* GPU__GC__TMP_SCBD_SLOTS_PER_CU */
		gc-lds-size = <128>;			/* GPU__LDS__SIZE */
		num-sc-per-sh =	<0>;			/* GPU__GC__NUM_SC_PER_SE / GPU__GC__NUM_SA_PER_SE */
		num-packer-per-sc = <4>;		/* GPU__GC__NUM_PACKER_PER_SC */
	};
};
