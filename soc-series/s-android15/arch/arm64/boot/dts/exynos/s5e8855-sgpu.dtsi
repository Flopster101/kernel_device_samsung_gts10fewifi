
/*
 * SAMSUNG SGPU device tree sourceA
 *
 * Copyright (c) 2023 Samsung Electronics Co., Ltd.
 *		http://www.samsung.com
 *
 * This program is free software; you can redistribute it and/or modify
 * it under the terms of the GNU General Public License version 2 as
 * published by the Free Software Foundation.
 */

#define CHIP_VANGOGH_LITE 30


#define IFPO_DISABLED    0x0
#define IFPO_ABORT       0x1
#define IFPO_HALF_AUTO   0x2

/{
	/* sgpu */
	sgpu: sgpu@10E00000 {
		#cooling-cells = <2>; /* min followed by max */
		compatible = "samsung-sgpu,samsung-sgpu";
		reg = <
			0x0 0x10E00000 0x100000
			0x0 0x10F00000 0x2000
			0x0 0x10CC0000 0x10000
			0x0 0x10CD0000 0x10000
			0x0 0x10C00000 0x2000
			0x0 0x10C40000 0x10000>;
		reg-names = "gpu", "doorbell", "debug", "pwrctl", "sysreg", "htu";
		interrupts = <GIC_SPI INTREQ__GPU_INT IRQ_TYPE_LEVEL_HIGH>,
			     <GIC_SPI INTREQ__HTU_G3D_INT IRQ_TYPE_LEVEL_HIGH>;
		interrupt-names =  "SGPU", "GPU-AFM";
		flags = <CHIP_VANGOGH_LITE>;
		chip_revision = <0x02300100>;
		gl2acem_instances_count = <0x1>;
		samsung,imgloader-s2mpu-support;
		power-domains = <&pd_g3dcore>;

		/* IFPO */
		ifpo_type = <IFPO_ABORT>;
		ifpo_cal_id = <0xB1380010>;

		/*GPU DVFS*/
		freq_table = <102000 252000 356000 450000 544000 648000 750000
				864000 960000 1025000 1100000 1152000 1200000 1250000 1300000 1408000>;
		g3d_cmu_cal_id = <ACPM_DVFS_G3D>;
		min_freq = <450000>;
		max_freq = <1408000>;
		min_threshold = "0 252000:60 450000:65 750000:78";
		max_threshold = "75 252000:80 450000:85 648000:90 750000:95";
		downstay_time = "32 544000:64 648000:96 960000:160";
		mif_min_lock = "421000 544000:1352000 648000:1539000 750000:1716000 864000:2093000 960000:2535000 1025000:2730000 1100000:3172000 1152000:3172000";
		mif_cl_boost_min_lock = "421000 450000:1014000 648000:1352000 750000:1539000 864000:1794000 960000:2093000";
		cl_boost_freq = <1300000>;
		mo_scenario = "default 450000:g3d_performance";
		llc_ways = "0 544000:16";
		highspeed_freq = <544000>;
		highspeed_load = <99>;
		highspeed_delay = <0>;
		gpu_power_coeff = <625>;
		ect-coeff-index = <2>;
		dm_type = <DM_G3D>;

                /* GPU AFM */
                interrupt-src = <1>; /* MAIN_PMIC=1, SUB_PMIC=2, EXTRA_PMIC=3 */
                pmic-num = <1>;
                s2mps-afm-enable-offset = <0x44>; /* AFM enable */
                s2mps-afm-level-offset = <0x44>; /* AFM level */
                down-step = <1>;
                release-duration = <15>;
                register-duration = <15000>; /* GPU init faster than loading PMIC interface */

		didt_threshold = <450000>;
		edc_threshold = <1408000>;
		didt = <0x0 0x2225A661 0x1 0x3EC00000 0x2 0x30200232 0x4 0x00104210 0x5 0x008C8323
			0x10 0x53ff4933 0x11 0x0000002a 0x14 0x00401c51 0x15 0x00000074 0x16 0x01010001
			0x17 0x11110421 0x18 0x25291249 0x19 0x00002aaa>;
		/* CMU_G3D_CORE base phy addr, found in SFR map */
		cmug3dcore_phyaddrbase = <0x10C30000>;

		/* GPU INFO */
		gc-max-shader-engines = <1>;		/* GPU__GC__NUM_SE */
		gc-max-cu-per-sh = <2>;			/* GPU__GC__NUM_SA_PER_SE * GPU__GC__NUM_WGP_PER_SA */
		gc-max-sh-per-se = <1>;			/* GPU__GC__NUM_SA_PER_SE */
		gc-max-backends-per-se = <1>;		/* GPU__GC__NUM_RB_PER_SE */
		gc-max-texture-channel-caches = <1>;	/* GPU__GC__NUM_GL2C */
		gc-max-gprs = <1024>;			/* GPU__GC__NUM_GPRS */
		gc-max-gs-threads = <32>;		/* GPU__GC__NUM_MAX_GS_THDS */
		gc-vgt-table-depth = <32>;		/* GPU__GC__GS_TABLE_DEPTH */
		gc-prim-buffer-depth = <1792>;		/* GPU__GC__GSPRIM_BUFF_DEPTH */
		gc-double-offchip-lds-buffer = <1>;	/* GPU__GC__DOUBLE_OFFCHIP_LDS_BUFFER */
		gc-wave-front-size = <32>;		/* GC__SQ_WAVE_SIZE */
		gc-max-waves-per-simd = <16>;		/* GPU__GC__NUM_WAVES_PER_SIMD */
		gc-max-scratch-slots-per-cu = <32>;	/* GPU__GC__TMP_SCBD_SLOTS_PER_CU */
		gc-lds-size = <64>;			/* GPU__LDS__SIZE */
		num-sc-per-sh =	<1>;			/* GPU__GC__NUM_SC_PER_SE / GPU__GC__NUM_SA_PER_SE */
		num-packer-per-sc = <1>;		/* GPU__GC__NUM_PACKER_PER_SC */
	};
};

