/* SPDX-License-Identifier: GPL-2.0-only */
/*
 * EXYNOS M2M device tree source for M2M IP(MSCL, SMFC)
 *
 * Copyright (c) 2012 Samsung Electronics Co., Ltd.
 *		http://www.samsung.com
 */
//#include <dt-bindings/clock/s5e8845.h>
#include <dt-bindings/interrupt-controller/s5e8855.h>
#include <dt-bindings/soc/samsung/exynos_pm_qos.h>

/ {
	aliases {
		smfc0 = &smfc_0;
                scaler0 = &scaler_0;
	};

	smfc_0: smfc@16090000 {
		compatible = "samsung,exynos8890-jpeg";
	/*	dma-coherent;*/
		reg = <0x0 0x16090000 0x1000>;
		interrupts = <0 INTREQ__JPEG IRQ_TYPE_LEVEL_HIGH>;
	        iommus = <&sysmmu_m2m_s0>;
		samsung,iommu-group=<&iommu_group_mscl_smfc>;
                core_dvfs_class = <PM_QOS_INTCAM_THROUGHPUT>;
                smfc,core_qos_minlock = <800000>;
                smfc,mif_qos_minlock = <1352000>;
                smfc_bpc = <16>;
                smfc_core_clk = <800000>;
	};

	scaler_0: scaler@16060000 {
		compatible = "samsung,exynos5-scaler";
		reg = <0x0 0x16060000 0x3000>;
		interrupts = <0 INTREQ__M2M IRQ_TYPE_LEVEL_HIGH>;
		itmon,master = "MSCL";
		itmon,dest = "M2M";
        /*	dma-coherent;*/
		iommus = <&sysmmu_m2m_s0>;
		samsung,iommu-group=<&iommu_group_mscl_smfc>;
		samsung,tzmp;

		#dma-address-cells = <1>;
		#dma-size-cells = <1>;
		dma-window = <0x0 0xE0000000>;

		/* MIF (not used) | INT | MSCL_clock */
                mscl_qos_table = < 0 800000 800000
                                   0 600000 600000
                                   0 533000 533000
                                   0 400000 400000
                                   0 333000 333000
                                   0 267000 267000
                                   0 200000 200000
                                   0 178000 178000 >;
		/* bpp means, YUV420(12), YUV422(16), P010(24), RGB(32), SBWC(100) */
		/* bpp | ppc * 100 | ppc * 100 with rotation */
		mscl_ppc_table = <  12  392 384
				    16  304 293
				    24  225 223
                                    32  163 158
				   100  412 374 >;
		mscl_mif_ref = < 845000 >;
		mscl_bw_ref = < 3037500 >;
                mscl_dvfs_class = <PM_QOS_INTCAM_THROUGHPUT>;

                /* bpp means, YUV420(12), YUV422(16), P010(24), RGB(32), SBWC(100) */
                /* bpp | min_bus_int */
                mscl_min_bus_int_table = < 12 178000
                                           16 178000
                                           24 178000
                                           32 178000
                                          100 178000 >;
	};

};
