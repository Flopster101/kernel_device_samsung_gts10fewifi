/*
 * SAMSUNG S5E8855 SoC UARCH device tree source
 *
 * Copyright (c) 2024 Samsung Electronics Co., Ltd.
 *             http://www.samsung.com
 *
 * SAMSUNG EXYNOS8855 SoC device nodes are listed in this file.
 * EXYNOS based board files can include this file and provide
 * values for board specfic bindings.
 *
 * This program is free software; you can redistribute it and/or modify
 * it under the terms of the GNU General Public License version 2 as
 * published by the Free Software Foundation.
 */

/ {
	hts {
		compatible = "samsung,hts";
		handle = <&devfreq_0>;
	};
};
